## CMakeLists.txt
```
# Copyright (c) 2026 Troposound
# SPDX-License-Identifier: Apache-2.0

cmake_minimum_required(VERSION 3.20.0)
find_package(Zephyr REQUIRED HINTS $ENV{ZEPHYR_BASE})
project(le_audio_broadcast)

target_sources(app PRIVATE src/main.c src/led.c src/controls.c)
target_sources_ifdef(CONFIG_BROADCAST_ROLE_SOURCE app PRIVATE src/source.c)
target_sources_ifdef(CONFIG_BROADCAST_ROLE_SINK app PRIVATE src/sink.c)
target_sources_ifdef(CONFIG_BROADCAST_LED_STRIP app PRIVATE src/strip.c)
```

## Kconfig
```
# Copyright (c) 2026 Troposound
# SPDX-License-Identifier: Apache-2.0

mainmenu "Troposound LE Audio broadcast"

choice BROADCAST_ROLE
	prompt "LE Audio broadcast role"
	default BROADCAST_ROLE_SOURCE

config BROADCAST_ROLE_SOURCE
	bool "Broadcast source (microphone -> LC3 -> BIG)"

config BROADCAST_ROLE_SINK
	bool "Broadcast sink (BIG -> LC3 -> headphones)"

endchoice

config BROADCAST_NAME
	string "Broadcast name"
	default "Troposound R1" if BOARD_R1
	default "Troposound H1" if BOARD_H1
	default "Troposound"
	depends on BROADCAST_ROLE_SOURCE
	help
	  Broadcast_Name AD shown by phones and broadcast assistants (4-32 bytes).

choice BROADCAST_SAMPLE_RATE
	prompt "LC3 sample rate (mono, 10 ms frames)"
	default BROADCAST_SAMPLE_RATE_24K
	depends on BROADCAST_ROLE_SOURCE

config BROADCAST_SAMPLE_RATE_24K
	bool "24 kHz, 60 octets (BAP 24_2_1, PBP standard quality)"

config BROADCAST_SAMPLE_RATE_48K
	bool "48 kHz, 100 octets (BAP 48_2_1, PBP high quality)"

endchoice

config BROADCAST_TARGET_NAME
	string "Broadcast name filter (substring, empty = any)"
	default ""
	depends on BROADCAST_ROLE_SINK
	help
	  Sink only syncs to a broadcast whose Broadcast_Name or device name
	  contains this string (case-insensitive). Empty syncs to the first
	  broadcast audio source found.

config BROADCAST_VOLUME_HALF_DB
	int "Start-up volume with the rotary encoder, in 0.5 dB steps"
	range -120 12
	default -20
	depends on BROADCAST_ROLE_SINK
	help
	  The H1 rotary encoder starts here. The R1 volume knob sets the
	  volume from its position.

config BROADCAST_LED_STRIP
	bool "Music-reactive LED strip"
	default y
	depends on BROADCAST_ROLE_SINK
	depends on $(dt_alias_enabled,led-strip)
	depends on DT_HAS_WORLDSEMI_WS2812_SPI_ENABLED
	select SPI
	help
	  Lights the WS2812 led-strip alias to the received audio, scaled to
	  its chain-length. The smart button cycles blue bass bloom, VU meter,
	  spectrum, beat strobe, beat ripples and off.

config AUDIO
	default y

config AUDIO_CODEC
	default y

config TROPOSOUND_AUDIO_I2S
	default y

config BT_ISO_BROADCASTER
	default y if BROADCAST_ROLE_SOURCE

config BT_BAP_BROADCAST_SOURCE
	default y if BROADCAST_ROLE_SOURCE

config BT_PBP
	default y if BROADCAST_ROLE_SOURCE

config BT_OBSERVER
	default y if BROADCAST_ROLE_SINK

config BT_PERIPHERAL
	default y if BROADCAST_ROLE_SINK

config BT_PER_ADV_SYNC
	default y if BROADCAST_ROLE_SINK

config BT_ISO_SYNC_RECEIVER
	default y if BROADCAST_ROLE_SINK

config BT_SMP
	default y if BROADCAST_ROLE_SINK

config BT_GATT_DYNAMIC_DB
	default y if BROADCAST_ROLE_SINK

config BT_PAC_SNK
	default y if BROADCAST_ROLE_SINK

config BT_BAP_SCAN_DELEGATOR
	default y if BROADCAST_ROLE_SINK

config BT_BAP_BROADCAST_SINK
	default y if BROADCAST_ROLE_SINK

config BT_BAP_BROADCAST_SRC_STREAM_COUNT
	default 1

config BT_BAP_BROADCAST_SRC_SUBGROUP_COUNT
	default 1

config BT_BAP_BROADCAST_SNK_STREAM_COUNT
	default 2

config BT_BAP_BROADCAST_SNK_SUBGROUP_COUNT
	default 1

config BT_BAP_BASS_MAX_SUBGROUPS
	default 1

source "Kconfig.zephyr"
```

## Kconfig.sysbuild
```
# Copyright (c) 2026 Troposound
# SPDX-License-Identifier: Apache-2.0

config NRF_DEFAULT_IPC_RADIO
	default y

config NETCORE_IPC_RADIO_BT_HCI_IPC
	default y

source "share/sysbuild/Kconfig"
```

## sample.yaml
```
# Copyright (c) 2026 Troposound
# SPDX-License-Identifier: Apache-2.0

sample:
  name: LE Audio broadcast
  description: LE Audio broadcast source or sink with LC3 and the TAC5211
common:
  sysbuild: true
  build_only: true
  tags:
    - bluetooth
    - audio
  integration_platforms:
    - h1/nrf5340/cpuapp
    - r1/nrf5340/cpuapp
  platform_allow:
    - h1/nrf5340/cpuapp
    - r1/nrf5340/cpuapp
tests:
  sample.troposound.le_audio_broadcast.source: {}
  sample.troposound.le_audio_broadcast.sink:
    extra_args:
      - EXTRA_CONF_FILE=sink.conf
```

## prj.conf
```kconfig
# Copyright (c) 2026 Troposound
# SPDX-License-Identifier: Apache-2.0

CONFIG_INPUT=y
CONFIG_LOG=y
CONFIG_TROPOSOUND_HEADSET=y
CONFIG_MAIN_STACK_SIZE=4096

CONFIG_BT=y
CONFIG_BT_AUDIO=y
CONFIG_BT_EXT_ADV=y
CONFIG_UTF8=y

# One mono BIS
CONFIG_BT_ISO_MAX_CHAN=1
CONFIG_BT_ISO_TX_BUF_COUNT=4
CONFIG_BT_ISO_TX_MTU=120
CONFIG_BT_ISO_RX_BUF_COUNT=6
CONFIG_BT_ISO_RX_MTU=160

# Phones put long metadata into the BASE
CONFIG_BT_AUDIO_CODEC_CFG_MAX_METADATA_SIZE=64
CONFIG_BT_AUDIO_CODEC_CFG_MAX_DATA_SIZE=64
CONFIG_BT_AUDIO_CODEC_CAP_MAX_METADATA_SIZE=64
CONFIG_BT_AUDIO_CODEC_CAP_MAX_DATA_SIZE=64

CONFIG_BT_DEVICE_NAME="Troposound Broadcast"

CONFIG_LIBLC3=y
CONFIG_FPU=y
```

## sink.conf
```kconfig
# Copyright (c) 2026 Troposound
# SPDX-License-Identifier: Apache-2.0

# Build the broadcast sink: west build ... -- -DEXTRA_CONF_FILE=sink.conf
CONFIG_BROADCAST_ROLE_SINK=y
CONFIG_TROPOSOUND_VOLUME=y

# Left and right BIS
CONFIG_BT_ISO_MAX_CHAN=2
CONFIG_BT_ISO_RX_BUF_COUNT=12
```

## src/main.c
```c
/*
 * Copyright (c) 2026 Troposound
 *
 * SPDX-License-Identifier: Apache-2.0
 */

#include <nrfx_clock.h>
#include <zephyr/kernel.h>
#include <zephyr/logging/log.h>

#include "broadcast.h"

LOG_MODULE_REGISTER(broadcast, LOG_LEVEL_INF);

int main(void)
{
	int err;

	/* LC3 runs on the app core: use 128 MHz instead of the 64 MHz default */
	err = nrfx_clock_divider_set(NRF_CLOCK_DOMAIN_HFCLK, NRF_CLOCK_HFCLK_DIV_1);
	if (err) {
		LOG_WRN("Could not set 128 MHz (%d)", err);
	}

	err = led_init();
	if (err) {
		LOG_WRN("LED init failed (%d)", err);
	}

	LOG_INF("LE Audio broadcast %s on %s",
		IS_ENABLED(CONFIG_BROADCAST_ROLE_SOURCE) ? "source" : "sink", CONFIG_BOARD);

	err = role_run();
	if (err) {
		LOG_ERR("Stopped (%d)", err);
		led_state_set(LED_STATE_ERROR);
	}

	return 0;
}
```

## src/broadcast.h
```c
/*
 * Copyright (c) 2026 Troposound
 *
 * SPDX-License-Identifier: Apache-2.0
 */

#ifndef BROADCAST_H_
#define BROADCAST_H_

#include <stdbool.h>
#include <stdint.h>

#include <zephyr/device.h>
#include <zephyr/sys/util.h>

enum led_state {
	LED_STATE_OFF,
	LED_STATE_SEARCHING, /* blue blinking: advertising (source) / scanning (sink) */
	LED_STATE_STREAMING, /* solid green, yellow while muted */
	LED_STATE_ERROR,     /* solid red */
};

int led_init(void);
void led_state_set(enum led_state state);
void led_muted_set(bool muted);

/* Buttons, volume knob/encoder and jack detect. Call once the codec runs. */
void controls_start(const struct device *codec);
bool controls_muted(void);

int role_run(void);

#define STRIP_FRAME_SAMPLES 480 /* 10 ms of 48 kHz stereo, left in the low half-word */

#if defined(CONFIG_BROADCAST_LED_STRIP)
void strip_audio_feed(const uint32_t *pcm);
void strip_mode_next(void);
#else
static inline void strip_audio_feed(const uint32_t *pcm)
{
	ARG_UNUSED(pcm);
}

static inline void strip_mode_next(void)
{
}
#endif

#endif /* BROADCAST_H_ */
```

## src/controls.c
```c
/*
 * Copyright (c) 2026 Troposound
 *
 * SPDX-License-Identifier: Apache-2.0
 */

#include <troposound/headset.h>
#include <troposound/volume.h>
#include <zephyr/audio/codec.h>
#include <zephyr/input/input.h>
#include <zephyr/kernel.h>
#include <zephyr/logging/log.h>
#include <zephyr/sys/atomic.h>

#include "broadcast.h"

LOG_MODULE_REGISTER(controls, LOG_LEVEL_INF);

static const struct device *codec;
static atomic_t mute_state;

bool controls_muted(void)
{
	return atomic_get(&mute_state);
}

static void mute_toggle(void)
{
	bool muted = !atomic_xor(&mute_state, 1);

	if (IS_ENABLED(CONFIG_BROADCAST_ROLE_SINK)) {
		audio_codec_set_property(codec, AUDIO_PROPERTY_OUTPUT_MUTE, AUDIO_CHANNEL_ALL,
					 (audio_property_value_t){.mute = muted});
		audio_codec_apply_properties(codec);
	}

	led_muted_set(muted);
	LOG_INF("%s", muted ? "Muted" : "Unmuted");
}

static void input_cb(struct input_event *evt, void *user_data)
{
	ARG_UNUSED(user_data);

	if (codec == NULL || evt->type != INPUT_EV_KEY) {
		return;
	}

	switch (evt->code) {
	case INPUT_KEY_0:    /* R1 PTT */
	case INPUT_KEY_MUTE: /* H1 mute */
		if (evt->value) {
			mute_toggle();
		}
		break;
	case INPUT_KEY_PLAYPAUSE: /* H1 smart button */
		if (evt->value) {
			strip_mode_next();
		}
		break;
	default:
		break;
	}
}

INPUT_CALLBACK_DEFINE(NULL, input_cb, NULL);

void controls_start(const struct device *dev)
{
	codec = dev;

	(void)headset_start(codec);

#if IS_ENABLED(CONFIG_BROADCAST_ROLE_SINK)
	(void)volume_start(codec, CONFIG_BROADCAST_VOLUME_HALF_DB);
#endif
}
```

## src/led.c
```c
/*
 * Copyright (c) 2026 Troposound
 *
 * SPDX-License-Identifier: Apache-2.0
 */

#include <zephyr/drivers/gpio.h>
#include <zephyr/kernel.h>

#include "broadcast.h"

#define BLINK_PERIOD K_MSEC(250)

static const struct gpio_dt_spec led_red = GPIO_DT_SPEC_GET(DT_ALIAS(led0), gpios);
static const struct gpio_dt_spec led_green = GPIO_DT_SPEC_GET(DT_ALIAS(led1), gpios);
static const struct gpio_dt_spec led_blue = GPIO_DT_SPEC_GET(DT_ALIAS(led2), gpios);

static enum led_state cur_state;
static bool muted;
static bool blink_on;

static void blink_handler(struct k_work *work);
static K_WORK_DELAYABLE_DEFINE(blink_work, blink_handler);

static void blink_handler(struct k_work *work)
{
	if (cur_state != LED_STATE_SEARCHING) {
		return;
	}

	blink_on = !blink_on;
	gpio_pin_set_dt(&led_blue, blink_on);
	k_work_reschedule(&blink_work, BLINK_PERIOD);
}

int led_init(void)
{
	const struct gpio_dt_spec *leds[] = {&led_red, &led_green, &led_blue};

	for (size_t i = 0; i < ARRAY_SIZE(leds); i++) {
		if (!gpio_is_ready_dt(leds[i])) {
			return -ENODEV;
		}

		int err = gpio_pin_configure_dt(leds[i], GPIO_OUTPUT_INACTIVE);

		if (err) {
			return err;
		}
	}

	return 0;
}

/* Red + green = yellow: streaming while muted */
static void red_green_update(void)
{
	bool streaming = cur_state == LED_STATE_STREAMING;

	gpio_pin_set_dt(&led_red, cur_state == LED_STATE_ERROR || (streaming && muted));
	gpio_pin_set_dt(&led_green, streaming);
}

void led_muted_set(bool mute)
{
	muted = mute;
	red_green_update();
}

void led_state_set(enum led_state state)
{
	if (state == cur_state) {
		return;
	}

	cur_state = state;
	k_work_cancel_delayable(&blink_work);
	blink_on = false;

	red_green_update();
	gpio_pin_set_dt(&led_blue, 0);

	if (state == LED_STATE_SEARCHING) {
		k_work_reschedule(&blink_work, K_NO_WAIT);
	}
}
```

## src/sink.c
```c
/*
 * Copyright (c) 2026 Troposound
 *
 * SPDX-License-Identifier: Apache-2.0
 */

/* Front left/right BIS -> LC3 48 kHz -> TAC5211; without a pair the first BIS plays on both */

#include <string.h>
#include <strings.h>

#include <lc3.h>
#include <troposound/audio_i2s.h>
#include <troposound/headset.h>
#include <zephyr/audio/codec.h>
#include <zephyr/bluetooth/audio/audio.h>
#include <zephyr/bluetooth/audio/bap.h>
#include <zephyr/bluetooth/audio/pacs.h>
#include <zephyr/bluetooth/bluetooth.h>
#include <zephyr/bluetooth/iso.h>
#include <zephyr/bluetooth/uuid.h>
#include <zephyr/kernel.h>
#include <zephyr/logging/log.h>
#include <zephyr/sys/atomic.h>
#include <zephyr/sys/byteorder.h>

#include "broadcast.h"

LOG_MODULE_REGISTER(broadcast_sink, LOG_LEVEL_INF);

#define PCM_RATE_HZ    48000
#define FRAME_US       10000
#define FRAME_SAMPLES  (PCM_RATE_HZ / 100)
#define BLOCK_COUNT    4
#define PRIME_BLOCKS   2
#define MAX_SDU        155
#define STEP_TIMEOUT   K_SECONDS(5)
#define NAME_LEN       (BT_AUDIO_BROADCAST_NAME_LEN_MAX + 1)
#define MAX_STREAMS    2

BUILD_ASSERT(AUDIO_I2S_BLOCK_WORDS == FRAME_SAMPLES, "I2S block must be one 10 ms LC3 frame");
BUILD_ASSERT(STRIP_FRAME_SAMPLES == FRAME_SAMPLES);

struct lc3_frame {
	uint16_t len;
	uint8_t stream;
	bool valid;
	uint8_t data[MAX_SDU];
};

K_MSGQ_DEFINE(frame_q, sizeof(struct lc3_frame), MAX_STREAMS * BLOCK_COUNT, 4);
K_MSGQ_DEFINE(free_q, sizeof(uint32_t *), BLOCK_COUNT, sizeof(uint32_t *));
K_MSGQ_DEFINE(ready_q, sizeof(uint32_t *), BLOCK_COUNT, sizeof(uint32_t *));

static uint32_t pcm_blocks[BLOCK_COUNT][FRAME_SAMPLES];
static uint32_t tx_silence[FRAME_SAMPLES]; /* EasyDMA reads RAM only */
static uint32_t rx_scratch[FRAME_SAMPLES];
static bool primed;

static lc3_decoder_mem_48k_t lc3_mem[MAX_STREAMS];
static lc3_decoder_t lc3_dec[MAX_STREAMS];
static uint8_t stream_slot[MAX_STREAMS]; /* 0 left, 1 right */
static size_t stream_count;

static void i2s_cb(uint32_t *released_rx, const uint32_t *released_tx)
{
	const uint32_t *next = tx_silence;

	ARG_UNUSED(released_rx);

	if (released_tx != NULL && released_tx != tx_silence) {
		uint32_t *blk = (uint32_t *)released_tx;

		(void)k_msgq_put(&free_q, &blk, K_NO_WAIT);
	}

	if (!primed && k_msgq_num_used_get(&ready_q) >= PRIME_BLOCKS) {
		primed = true;
	}

	if (primed) {
		uint32_t *blk;

		if (k_msgq_get(&ready_q, &blk, K_NO_WAIT) == 0) {
			next = blk;
		} else {
			primed = false; /* Underrun: refill before playing again */
		}
	}

	(void)audio_i2s_set_next_buf(next, rx_scratch);
}

static void frames_play(const struct lc3_frame *frames, uint32_t have)
{
	const size_t count = stream_count;
	uint32_t *blk;

	for (size_t i = 0; i < count; i++) {
		if (lc3_dec[i] == NULL) {
			return;
		}
	}

	if (k_msgq_get(&free_q, &blk, K_NO_WAIT) != 0) {
		return; /* Playback is behind: drop */
	}

	for (size_t i = 0; i < count; i++) {
		const struct lc3_frame *f = &frames[i];
		const bool ok = (have & BIT(i)) && f->valid;

		(void)lc3_decode(lc3_dec[i], ok ? f->data : NULL, f->len, LC3_PCM_FORMAT_S16,
				 (int16_t *)blk + stream_slot[i], 2);
	}

	if (count == 1) {
		/* Mono to both slots: left is in the low half-word */
		for (size_t i = 0; i < FRAME_SAMPLES; i++) {
			blk[i] = (blk[i] & 0xFFFFU) | (blk[i] << 16);
		}
	}

	strip_audio_feed(blk);
	(void)k_msgq_put(&ready_q, &blk, K_NO_WAIT);
}

/* Each BIS delivers one frame per BIG event; a stream seen twice closes the event */
static void decoder_thread(void *p1, void *p2, void *p3)
{
	static struct lc3_frame frames[MAX_STREAMS];
	struct lc3_frame frame;
	uint32_t have = 0;

	while (true) {
		k_msgq_get(&frame_q, &frame, K_FOREVER);

		if (frame.stream >= stream_count) {
			continue;
		}

		if (have & BIT(frame.stream)) {
			frames_play(frames, have);
			have = 0;
		}

		frames[frame.stream] = frame;
		have |= BIT(frame.stream);

		if (have == BIT_MASK(stream_count)) {
			frames_play(frames, have);
			have = 0;
		}
	}
}

K_THREAD_DEFINE(decoder_tid, 4096, decoder_thread, NULL, NULL, NULL, 5, 0, 0);

static int audio_out_start(void)
{
	const struct device *codec = DEVICE_DT_GET(DT_NODELABEL(tac5211));
	struct audio_codec_cfg cfg = {
		.mclk_freq = 0,
		.dai_type = AUDIO_DAI_TYPE_I2S,
		.dai_route = AUDIO_ROUTE_PLAYBACK_CAPTURE,
		.dai_cfg.i2s = {
			.word_size = 16,
			.channels = 2,
			.format = I2S_FMT_DATA_FORMAT_I2S,
			.frame_clk_freq = PCM_RATE_HZ,
		},
	};
	int err;

	if (!device_is_ready(codec)) {
		LOG_ERR("TAC5211 not ready");
		return -ENODEV;
	}

	for (size_t i = 0; i < BLOCK_COUNT; i++) {
		uint32_t *blk = pcm_blocks[i];

		(void)k_msgq_put(&free_q, &blk, K_NO_WAIT);
	}

	err = audio_i2s_init();
	if (err) {
		LOG_ERR("I2S init failed (%d)", err);
		return err;
	}

	audio_i2s_callback_set(i2s_cb);

	err = audio_i2s_start(tx_silence, rx_scratch);
	if (err) {
		LOG_ERR("I2S start failed (%d)", err);
		return err;
	}

	/* Codec auto-detects its clocks from BCLK/FSYNC, so configure after start */
	err = audio_codec_configure(codec, &cfg);
	if (err) {
		LOG_ERR("TAC5211 configure failed (%d)", err);
		return err;
	}

	audio_codec_set_property(codec, AUDIO_PROPERTY_OUTPUT_MUTE, AUDIO_CHANNEL_ALL,
				 (audio_property_value_t){.mute = false});
	audio_codec_apply_properties(codec);
	audio_codec_start_output(codec);
	controls_start(codec);

	return 0;
}

static K_SEM_DEFINE(sem_found, 0, 1);
static K_SEM_DEFINE(sem_pa_synced, 0, 1);
static K_SEM_DEFINE(sem_base, 0, 1);
static K_SEM_DEFINE(sem_syncable, 0, 1);
static K_SEM_DEFINE(sem_started, 0, MAX_STREAMS);
static K_SEM_DEFINE(sem_lost, 0, 1);
static K_SEM_DEFINE(sem_stopped, 0, 1);

static struct bt_bap_stream stream_pool[MAX_STREAMS];
static struct bt_bap_stream *streams[] = {&stream_pool[0], &stream_pool[1]};
static struct bt_bap_broadcast_sink *sink;
static struct bt_le_per_adv_sync *pa_sync;
static bt_addr_le_t found_addr;
static uint8_t found_sid;
static uint16_t found_interval;
static uint32_t found_id;
static atomic_t searching;
static uint32_t bis_bitfield;
static bool big_encrypted;

static const struct bt_audio_codec_cap codec_cap = BT_AUDIO_CODEC_CAP_LC3(
	BT_AUDIO_CODEC_CAP_FREQ_16KHZ | BT_AUDIO_CODEC_CAP_FREQ_24KHZ |
		BT_AUDIO_CODEC_CAP_FREQ_32KHZ | BT_AUDIO_CODEC_CAP_FREQ_48KHZ,
	BT_AUDIO_CODEC_CAP_DURATION_10, BT_AUDIO_CODEC_CAP_CHAN_COUNT_SUPPORT(1), 26U, MAX_SDU,
	1U, BT_AUDIO_CONTEXT_TYPE_ANY);

static struct bt_pacs_cap cap = {
	.codec_cap = &codec_cap,
};

static void stream_started_cb(struct bt_bap_stream *s)
{
	const size_t idx = s - stream_pool;
	const struct bt_audio_codec_cfg *cfg = s->codec_cfg;
	enum bt_audio_location loc;
	int freq = bt_audio_codec_cfg_get_freq(cfg);
	int dur = bt_audio_codec_cfg_get_frame_dur(cfg);
	int freq_hz = freq > 0 ? bt_audio_codec_cfg_freq_to_freq_hz(freq) : -1;
	int dur_us = dur > 0 ? bt_audio_codec_cfg_frame_dur_to_frame_dur_us(dur) : -1;

	if (freq_hz <= 0 || dur_us != FRAME_US) {
		LOG_ERR("Unsupported stream: %d Hz, %d us", freq_hz, dur_us);
		return;
	}

	if (bt_audio_codec_cfg_get_chan_allocation(cfg, &loc, true) != 0) {
		loc = BT_AUDIO_LOCATION_MONO_AUDIO;
	}
	stream_slot[idx] = stream_count > 1 && (loc & BT_AUDIO_LOCATION_FRONT_RIGHT) &&
			   !(loc & BT_AUDIO_LOCATION_FRONT_LEFT);

	lc3_dec[idx] = lc3_setup_decoder(FRAME_US, freq_hz, PCM_RATE_HZ, &lc3_mem[idx]);
	LOG_INF("BIS %s started: LC3 %d Hz, %d octets",
		stream_count == 1 ? "mono" : (stream_slot[idx] ? "right" : "left"), freq_hz,
		bt_audio_codec_cfg_get_octets_per_frame(cfg));
	k_sem_give(&sem_started);
}

static void stream_stopped_cb(struct bt_bap_stream *s, uint8_t reason)
{
	LOG_INF("BIS stopped (0x%02x)", reason);
	lc3_dec[s - stream_pool] = NULL;
	k_sem_give(&sem_lost);
}

static void stream_recv_cb(struct bt_bap_stream *s, const struct bt_iso_recv_info *info,
			   struct net_buf *buf)
{
	struct lc3_frame frame = {
		.stream = s - stream_pool,
		.valid = (info->flags & BT_ISO_FLAGS_VALID) && buf->len > 0 && buf->len <= MAX_SDU,
	};

	if (frame.valid) {
		frame.len = buf->len;
		memcpy(frame.data, buf->data, buf->len);
	}

	(void)k_msgq_put(&frame_q, &frame, K_NO_WAIT);
}

static struct bt_bap_stream_ops stream_ops = {
	.started = stream_started_cb,
	.stopped = stream_stopped_cb,
	.recv = stream_recv_cb,
};

struct bis_choice {
	enum bt_audio_location subgroup_loc;
	uint8_t first;
	uint8_t left;
	uint8_t right;
};

static enum bt_audio_location chan_allocation(const struct bt_audio_codec_cfg *cfg,
					      enum bt_audio_location fallback)
{
	enum bt_audio_location loc;

	return bt_audio_codec_cfg_get_chan_allocation(cfg, &loc, false) == 0 ? loc : fallback;
}

static bool base_bis_cb(const struct bt_bap_base_subgroup_bis *bis, void *user_data)
{
	struct bis_choice *c = user_data;
	struct bt_audio_codec_cfg cfg = {0};
	enum bt_audio_location loc = c->subgroup_loc;

	if (bt_bap_base_subgroup_bis_codec_to_codec_cfg(bis, &cfg) == 0) {
		loc = chan_allocation(&cfg, loc);
	}

	loc &= BT_AUDIO_LOCATION_FRONT_LEFT | BT_AUDIO_LOCATION_FRONT_RIGHT;

	if (c->first == 0) {
		c->first = bis->index;
	}
	if (loc == BT_AUDIO_LOCATION_FRONT_LEFT && c->left == 0) {
		c->left = bis->index;
	} else if (loc == BT_AUDIO_LOCATION_FRONT_RIGHT && c->right == 0) {
		c->right = bis->index;
	}

	return true;
}

static bool base_subgroup_cb(const struct bt_bap_base_subgroup *subgroup, void *user_data)
{
	struct bis_choice *c = user_data;
	struct bt_audio_codec_cfg cfg = {0};

	/* A left/right pair has to come from one subgroup */
	c->left = 0;
	c->right = 0;
	c->subgroup_loc = BT_AUDIO_LOCATION_MONO_AUDIO;
	if (bt_bap_base_subgroup_codec_to_codec_cfg(subgroup, &cfg) == 0) {
		c->subgroup_loc = chan_allocation(&cfg, BT_AUDIO_LOCATION_MONO_AUDIO);
	}

	(void)bt_bap_base_subgroup_foreach_bis(subgroup, base_bis_cb, c);

	return c->left == 0 || c->right == 0;
}

static void base_recv_cb(struct bt_bap_broadcast_sink *s, const struct bt_bap_base *base,
			 size_t base_size)
{
	struct bis_choice c = {0};
	int err;

	if (bis_bitfield != 0) {
		return;
	}

	/* -ECANCELED: stopped early on a left/right pair */
	err = bt_bap_base_foreach_subgroup(base, base_subgroup_cb, &c);
	if ((err != 0 && err != -ECANCELED) || c.first == 0) {
		return;
	}

	if (c.left != 0 && c.right != 0) {
		stream_count = 2;
		bis_bitfield = BT_ISO_BIS_INDEX_BIT(c.left) | BT_ISO_BIS_INDEX_BIT(c.right);
	} else {
		stream_count = 1;
		bis_bitfield = BT_ISO_BIS_INDEX_BIT(c.first);
	}

	k_sem_give(&sem_base);
}

static void syncable_cb(struct bt_bap_broadcast_sink *s, const struct bt_iso_biginfo *biginfo)
{
	big_encrypted = biginfo->encryption;
	k_sem_give(&sem_syncable);
}

static void sink_stopped_cb(struct bt_bap_broadcast_sink *s, uint8_t reason)
{
	LOG_INF("Broadcast sink stopped (0x%02x)", reason);
	k_sem_give(&sem_stopped);
	k_sem_give(&sem_lost);
}

static struct bt_bap_broadcast_sink_cb sink_cb = {
	.base_recv = base_recv_cb,
	.syncable = syncable_cb,
	.stopped = sink_stopped_cb,
};

struct scan_ctx {
	uint32_t broadcast_id;
	bool name_match;
	char name[NAME_LEN];
};

static bool contains_nocase(const char *str, const char *sub)
{
	const size_t sub_len = strlen(sub);

	for (const char *p = str; strlen(p) >= sub_len; p++) {
		if (strncasecmp(p, sub, sub_len) == 0) {
			return true;
		}
	}

	return false;
}

static bool ad_parse_cb(struct bt_data *data, void *user_data)
{
	struct scan_ctx *ctx = user_data;

	switch (data->type) {
	case BT_DATA_SVC_DATA16:
		if (data->data_len >= BT_UUID_SIZE_16 + BT_AUDIO_BROADCAST_ID_SIZE &&
		    sys_get_le16(data->data) == BT_UUID_BROADCAST_AUDIO_VAL) {
			ctx->broadcast_id = sys_get_le24(data->data + BT_UUID_SIZE_16);
		}
		break;
	case BT_DATA_NAME_COMPLETE:
	case BT_DATA_NAME_SHORTENED:
	case BT_DATA_BROADCAST_NAME: {
		char name[NAME_LEN] = {0};

		memcpy(name, data->data, MIN(data->data_len, NAME_LEN - 1));
		if (strlen(CONFIG_BROADCAST_TARGET_NAME) == 0 ||
		    contains_nocase(name, CONFIG_BROADCAST_TARGET_NAME)) {
			ctx->name_match = true;
		}
		if (data->type == BT_DATA_BROADCAST_NAME || ctx->name[0] == '\0') {
			memcpy(ctx->name, name, sizeof(name));
		}
		break;
	}
	default:
		break;
	}

	return true;
}

static void scan_recv_cb(const struct bt_le_scan_recv_info *info, struct net_buf_simple *ad)
{
	struct scan_ctx ctx = {
		.broadcast_id = BT_BAP_INVALID_BROADCAST_ID,
		.name_match = strlen(CONFIG_BROADCAST_TARGET_NAME) == 0,
	};

	if (!atomic_get(&searching) || info->interval == 0U) {
		return;
	}

	bt_data_parse(ad, ad_parse_cb, &ctx);

	if (ctx.broadcast_id == BT_BAP_INVALID_BROADCAST_ID || !ctx.name_match) {
		return;
	}

	atomic_set(&searching, false);
	bt_addr_le_copy(&found_addr, info->addr);
	found_sid = info->sid;
	found_interval = info->interval;
	found_id = ctx.broadcast_id;
	LOG_INF("Found \"%s\" broadcast ID 0x%06x", ctx.name, found_id);
	k_sem_give(&sem_found);
}

static struct bt_le_scan_cb scan_cb = {
	.recv = scan_recv_cb,
};

static void pa_synced_cb(struct bt_le_per_adv_sync *sync,
			 struct bt_le_per_adv_sync_synced_info *info)
{
	if (sync == pa_sync) {
		k_sem_give(&sem_pa_synced);
	}
}

static void pa_term_cb(struct bt_le_per_adv_sync *sync,
		       const struct bt_le_per_adv_sync_term_info *info)
{
	if (sync == pa_sync) {
		LOG_INF("PA sync lost (0x%02x)", info->reason);
		pa_sync = NULL;
		k_sem_give(&sem_lost);
	}
}

static struct bt_le_per_adv_sync_cb pa_cb = {
	.synced = pa_synced_cb,
	.term = pa_term_cb,
};

static struct bt_bap_scan_delegator_cb scan_delegator_cb;

struct src_ids {
	uint8_t ids[CONFIG_BT_BAP_SCAN_DELEGATOR_RECV_STATE_COUNT];
	size_t count;
};

static bool src_id_collect(const struct bt_bap_scan_delegator_recv_state *state, void *user_data)
{
	struct src_ids *src = user_data;

	if (src->count < ARRAY_SIZE(src->ids)) {
		src->ids[src->count++] = state->src_id;
	}

	return false;
}

static void session_reset(void)
{
	struct src_ids src = {0};
	int err;

	headset_speaker_set(false);

	if (sink != NULL) {
		(void)bt_bap_broadcast_sink_stop(sink);
		(void)k_sem_take(&sem_stopped, K_SECONDS(2));
		err = bt_bap_broadcast_sink_delete(sink);
		if (err) {
			LOG_WRN("Broadcast sink delete failed (%d)", err);
		}
		sink = NULL;
	}

	/* Sink delete leaves the receive state; rem_src keeps it while it reads PA synced */
	bt_bap_scan_delegator_foreach_state(src_id_collect, &src);
	for (size_t i = 0; i < src.count; i++) {
		uint32_t no_bis[BT_BAP_BASS_MAX_SUBGROUPS] = {0};

		(void)bt_bap_scan_delegator_set_bis_sync_state(src.ids[i], no_bis);
		(void)bt_bap_scan_delegator_set_pa_state(src.ids[i], BT_BAP_PA_STATE_NOT_SYNCED);
		err = bt_bap_scan_delegator_rem_src(src.ids[i]);
		if (err) {
			LOG_WRN("Receive state %u remove failed (%d)", src.ids[i], err);
		}
	}

	if (pa_sync != NULL) {
		(void)bt_le_per_adv_sync_delete(pa_sync);
		pa_sync = NULL;
	}

	for (size_t i = 0; i < MAX_STREAMS; i++) {
		lc3_dec[i] = NULL;
	}
	stream_count = 0;
	bis_bitfield = 0;
	k_msgq_purge(&frame_q);
	k_sem_reset(&sem_found);
	k_sem_reset(&sem_pa_synced);
	k_sem_reset(&sem_base);
	k_sem_reset(&sem_syncable);
	k_sem_reset(&sem_started);
	k_sem_reset(&sem_lost);
	k_sem_reset(&sem_stopped);
}

static int session_run(void)
{
	static const uint8_t no_code[BT_ISO_BROADCAST_CODE_SIZE];
	struct bt_le_per_adv_sync_param pa_param = {0};
	int err;

	led_state_set(LED_STATE_SEARCHING);
	LOG_INF("Scanning for %s%s",
		strlen(CONFIG_BROADCAST_TARGET_NAME) ? "broadcast " : "any broadcast",
		CONFIG_BROADCAST_TARGET_NAME);

	atomic_set(&searching, true);
	err = bt_le_scan_start(BT_LE_SCAN_PASSIVE, NULL);
	if (err && err != -EALREADY) {
		LOG_ERR("scan_start failed (%d)", err);
		return err;
	}

	k_sem_take(&sem_found, K_FOREVER);
	(void)bt_le_scan_stop();

	bt_addr_le_copy(&pa_param.addr, &found_addr);
	pa_param.sid = found_sid;
	pa_param.skip = 0;
	/* 10 PA intervals in 10 ms units; interval is in 1.25 ms units */
	pa_param.timeout = CLAMP((found_interval * 125U) / 100U, BT_GAP_PER_ADV_MIN_TIMEOUT,
				 BT_GAP_PER_ADV_MAX_TIMEOUT);

	err = bt_le_per_adv_sync_create(&pa_param, &pa_sync);
	if (err) {
		LOG_ERR("PA sync create failed (%d)", err);
		return err;
	}

	if (k_sem_take(&sem_pa_synced, STEP_TIMEOUT)) {
		LOG_WRN("PA sync timeout");
		return -ETIMEDOUT;
	}

	err = bt_bap_broadcast_sink_create(pa_sync, found_id, &sink);
	if (err) {
		LOG_ERR("sink_create failed (%d)", err);
		return err;
	}

	if (k_sem_take(&sem_base, STEP_TIMEOUT) || k_sem_take(&sem_syncable, STEP_TIMEOUT)) {
		LOG_WRN("No BASE/BIGInfo");
		return -ETIMEDOUT;
	}

	if (big_encrypted) {
		LOG_WRN("Broadcast is encrypted, skipping");
		return -EACCES;
	}

	err = bt_bap_broadcast_sink_sync(sink, bis_bitfield, streams, no_code);
	if (err) {
		LOG_ERR("sink_sync failed (%d)", err);
		return err;
	}

	for (size_t i = 0; i < stream_count; i++) {
		if (k_sem_take(&sem_started, STEP_TIMEOUT)) {
			LOG_WRN("BIG sync timeout");
			return -ETIMEDOUT;
		}
	}

	led_state_set(LED_STATE_STREAMING);
	headset_speaker_set(true);
	k_sem_take(&sem_lost, K_FOREVER);
	LOG_INF("Stream lost");

	return 0;
}

int role_run(void)
{
	const struct bt_pacs_register_param pacs_param = {
		.snk_pac = true,
		.snk_loc = true,
	};
	int err;

	err = audio_out_start();
	if (err) {
		return err;
	}

	err = bt_enable(NULL);
	if (err) {
		LOG_ERR("bt_enable failed (%d)", err);
		return err;
	}

	err = bt_pacs_register(&pacs_param);
	if (err) {
		return err;
	}

	err = bt_pacs_cap_register(BT_AUDIO_DIR_SINK, &cap);
	if (err) {
		return err;
	}

	err = bt_bap_scan_delegator_register(&scan_delegator_cb);
	if (err) {
		return err;
	}

	err = bt_bap_broadcast_sink_register_cb(&sink_cb);
	if (err) {
		return err;
	}

	for (size_t i = 0; i < MAX_STREAMS; i++) {
		bt_bap_stream_cb_register(&stream_pool[i], &stream_ops);
	}
	bt_le_per_adv_sync_cb_register(&pa_cb);
	bt_le_scan_cb_register(&scan_cb);

	while (true) {
		err = session_run();
		if (err) {
			LOG_WRN("Session ended (%d), rescanning", err);
		}
		session_reset();
		k_sleep(K_MSEC(500));
	}

	return 0;
}
```

## src/source.c
```c
/*
 * Copyright (c) 2026 Troposound
 *
 * SPDX-License-Identifier: Apache-2.0
 */

/* TAC5211 mic (left I2S slot, 48 kHz) -> LC3 mono 10 ms -> one PBP BIS */

#include <string.h>

#include <lc3.h>
#include <troposound/audio_i2s.h>
#include <troposound/headset.h>
#include <zephyr/audio/codec.h>
#include <zephyr/bluetooth/audio/audio.h>
#include <zephyr/bluetooth/audio/bap.h>
#include <zephyr/bluetooth/audio/bap_lc3_preset.h>
#include <zephyr/bluetooth/audio/pbp.h>
#include <zephyr/bluetooth/bluetooth.h>
#include <zephyr/bluetooth/crypto.h>
#include <zephyr/bluetooth/iso.h>
#include <zephyr/bluetooth/uuid.h>
#include <zephyr/kernel.h>
#include <zephyr/logging/log.h>
#include <zephyr/net_buf.h>
#include <zephyr/sys/atomic.h>

#include "broadcast.h"

LOG_MODULE_REGISTER(broadcast_source, LOG_LEVEL_INF);

BUILD_ASSERT(IN_RANGE(sizeof(CONFIG_BROADCAST_NAME) - 1, BT_AUDIO_BROADCAST_NAME_LEN_MIN,
		      BT_AUDIO_BROADCAST_NAME_LEN_MAX),
	     "Invalid broadcast name length");

#define PCM_RATE_HZ      48000
#define FRAME_US         10000
#define FRAME_SAMPLES    (PCM_RATE_HZ / 100)
#define TX_BUF_COUNT     CONFIG_BT_ISO_TX_BUF_COUNT
#define PCM_BLOCK_COUNT  4

#if defined(CONFIG_BROADCAST_SAMPLE_RATE_48K)
static struct bt_bap_lc3_preset preset = BT_BAP_LC3_BROADCAST_PRESET_48_2_1(
	BT_AUDIO_LOCATION_MONO_AUDIO, BT_AUDIO_CONTEXT_TYPE_MEDIA);
#define LC3_RATE_HZ  48000
#define PBP_FEATURES BT_PBP_ANNOUNCEMENT_FEATURE_HIGH_QUALITY
#else
static struct bt_bap_lc3_preset preset = BT_BAP_LC3_BROADCAST_PRESET_24_2_1(
	BT_AUDIO_LOCATION_MONO_AUDIO, BT_AUDIO_CONTEXT_TYPE_MEDIA);
#define LC3_RATE_HZ  24000
#define PBP_FEATURES BT_PBP_ANNOUNCEMENT_FEATURE_STANDARD_QUALITY
#endif

BUILD_ASSERT(AUDIO_I2S_BLOCK_WORDS == FRAME_SAMPLES, "I2S block must be one 10 ms LC3 frame");

NET_BUF_POOL_FIXED_DEFINE(tx_pool, TX_BUF_COUNT, BT_ISO_SDU_BUF_SIZE(CONFIG_BT_ISO_TX_MTU),
			  CONFIG_BT_CONN_TX_USER_DATA_SIZE, NULL);

static struct bt_bap_stream stream;
static struct bt_bap_broadcast_source *broadcast_source;
static atomic_t streaming;
static uint16_t seq_num;

static lc3_encoder_mem_48k_t lc3_mem;
static lc3_encoder_t lc3_enc;

/* Interleaved stereo 16-bit PCM blocks; the encoder reads the left slot */
static uint32_t pcm_blocks[PCM_BLOCK_COUNT][FRAME_SAMPLES];
K_MSGQ_DEFINE(pcm_q, sizeof(uint32_t *), PCM_BLOCK_COUNT, sizeof(uint32_t *));

static K_SEM_DEFINE(sem_started, 0, 1);

static uint32_t tx_silence[FRAME_SAMPLES]; /* EasyDMA reads RAM only */
static const uint32_t mute_silence[FRAME_SAMPLES];
static size_t next_rx;

static void i2s_cb(uint32_t *released_rx, const uint32_t *released_tx)
{
	ARG_UNUSED(released_tx);

	if (released_rx != NULL) {
		/* Full: drop the block, the encoder is behind */
		(void)k_msgq_put(&pcm_q, &released_rx, K_NO_WAIT);
	}

	(void)audio_i2s_set_next_buf(tx_silence, pcm_blocks[next_rx]);
	next_rx = (next_rx + 1) % PCM_BLOCK_COUNT;
}

static int audio_in_start(void)
{
	const struct device *codec = DEVICE_DT_GET(DT_NODELABEL(tac5211));
	struct audio_codec_cfg cfg = {
		.mclk_freq = 0,
		.dai_type = AUDIO_DAI_TYPE_I2S,
		.dai_route = AUDIO_ROUTE_PLAYBACK_CAPTURE,
		.dai_cfg.i2s = {
			.word_size = 16,
			.channels = 2,
			.format = I2S_FMT_DATA_FORMAT_I2S,
			.frame_clk_freq = PCM_RATE_HZ,
		},
	};
	int err;

	if (!device_is_ready(codec)) {
		LOG_ERR("TAC5211 not ready");
		return -ENODEV;
	}

	err = audio_i2s_init();
	if (err) {
		LOG_ERR("I2S init failed (%d)", err);
		return err;
	}

	audio_i2s_callback_set(i2s_cb);

	/* First pair goes to start(), the second is queued from the first callback */
	next_rx = 1;
	err = audio_i2s_start(tx_silence, pcm_blocks[0]);
	if (err) {
		LOG_ERR("I2S start failed (%d)", err);
		return err;
	}

	/* Codec auto-detects its clocks from BCLK/FSYNC, so configure after start */
	err = audio_codec_configure(codec, &cfg);
	if (err) {
		LOG_ERR("TAC5211 configure failed (%d)", err);
		return err;
	}

	audio_codec_start_output(codec);
	controls_start(codec);
	return 0;
}

static void encoder_thread(void *p1, void *p2, void *p3)
{
	const int octets = preset.qos.sdu;
	uint8_t sdu[CONFIG_BT_ISO_TX_MTU];
	uint32_t *block;
	uint32_t sent = 0;
	uint32_t dropped = 0;

	while (true) {
		k_msgq_get(&pcm_q, &block, K_FOREVER);

		if (!atomic_get(&streaming)) {
			continue;
		}

		const uint32_t *pcm = controls_muted() ? mute_silence : block;

		/* Stride 2: left slot, mic is on ADC channel 1 */
		headset_mic_gain((int16_t *)block, FRAME_SAMPLES, 2);

		if (lc3_encode(lc3_enc, LC3_PCM_FORMAT_S16, (const int16_t *)pcm, 2, octets,
			       sdu) != 0) {
			LOG_ERR("lc3_encode failed");
			continue;
		}

		struct net_buf *buf = net_buf_alloc(&tx_pool, K_NO_WAIT);

		if (buf == NULL) {
			/* Controller queue full: I2S clock ran ahead of the ISO clock */
			dropped++;
			continue;
		}

		net_buf_reserve(buf, BT_ISO_CHAN_SEND_RESERVE);
		net_buf_add_mem(buf, sdu, octets);

		int err = bt_bap_stream_send(&stream, buf, seq_num++);

		if (err) {
			net_buf_unref(buf);
			dropped++;
			continue;
		}

		if ((++sent % 1000U) == 0U) {
			LOG_INF("Sent %u SDUs, dropped %u", sent, dropped);
		}
	}
}

K_THREAD_DEFINE(encoder_tid, 4096, encoder_thread, NULL, NULL, NULL, 5, 0, 0);

static void stream_started_cb(struct bt_bap_stream *s)
{
	seq_num = 0;
	atomic_set(&streaming, true);
	led_state_set(LED_STATE_STREAMING);
	LOG_INF("BIS started");
}

static void stream_stopped_cb(struct bt_bap_stream *s, uint8_t reason)
{
	atomic_set(&streaming, false);
	led_state_set(LED_STATE_SEARCHING);
	LOG_INF("BIS stopped (0x%02x)", reason);
}

static struct bt_bap_stream_ops stream_ops = {
	.started = stream_started_cb,
	.stopped = stream_stopped_cb,
};

static void source_started_cb(struct bt_bap_broadcast_source *source)
{
	k_sem_give(&sem_started);
}

static struct bt_bap_broadcast_source_cb source_cb = {
	.started = source_started_cb,
};

static int create_source(void)
{
	struct bt_bap_broadcast_source_stream_param stream_param = {
		.stream = &stream,
	};
	struct bt_bap_broadcast_source_subgroup_param subgroup_param = {
		.params_count = 1,
		.params = &stream_param,
		.codec_cfg = &preset.codec_cfg,
	};
	struct bt_bap_broadcast_source_param param = {
		.params_count = 1,
		.params = &subgroup_param,
		.qos = &preset.qos,
		.encryption = false,
		.packing = BT_ISO_PACKING_SEQUENTIAL,
	};

	bt_bap_stream_cb_register(&stream, &stream_ops);

	return bt_bap_broadcast_source_create(&param, &broadcast_source);
}

static int start_advertising(void)
{
	NET_BUF_SIMPLE_DEFINE(id_buf, BT_UUID_SIZE_16 + BT_AUDIO_BROADCAST_ID_SIZE);
	NET_BUF_SIMPLE_DEFINE(pba_buf, BT_UUID_SIZE_16 + 2 + 16);
	NET_BUF_SIMPLE_DEFINE(base_buf, 128);
	struct bt_le_ext_adv *adv;
	struct bt_data ext_ad[3];
	struct bt_data per_ad;
	uint32_t broadcast_id;
	int err;

	err = bt_le_ext_adv_create(BT_BAP_ADV_PARAM_BROADCAST_FAST, NULL, &adv);
	if (err) {
		LOG_ERR("ext_adv_create failed (%d)", err);
		return err;
	}

	err = bt_le_per_adv_set_param(adv, BT_BAP_PER_ADV_PARAM_BROADCAST_FAST);
	if (err) {
		LOG_ERR("per_adv_set_param failed (%d)", err);
		return err;
	}

	err = bt_rand(&broadcast_id, BT_AUDIO_BROADCAST_ID_SIZE);
	if (err) {
		return err;
	}
	broadcast_id &= BIT_MASK(24);

	net_buf_simple_add_le16(&id_buf, BT_UUID_BROADCAST_AUDIO_VAL);
	net_buf_simple_add_le24(&id_buf, broadcast_id);
	ext_ad[0] = (struct bt_data)BT_DATA(BT_DATA_SVC_DATA16, id_buf.data, id_buf.len);

	err = bt_pbp_get_announcement(NULL, 0, PBP_FEATURES, &pba_buf);
	if (err) {
		LOG_ERR("PBP announcement failed (%d)", err);
		return err;
	}
	ext_ad[1] = (struct bt_data)BT_DATA(BT_DATA_SVC_DATA16, pba_buf.data, pba_buf.len);

	ext_ad[2] = (struct bt_data)BT_DATA(BT_DATA_BROADCAST_NAME, CONFIG_BROADCAST_NAME,
					    sizeof(CONFIG_BROADCAST_NAME) - 1);

	err = bt_le_ext_adv_set_data(adv, ext_ad, ARRAY_SIZE(ext_ad), NULL, 0);
	if (err) {
		LOG_ERR("ext_adv_set_data failed (%d)", err);
		return err;
	}

	err = bt_bap_broadcast_source_get_base(broadcast_source, &base_buf);
	if (err) {
		LOG_ERR("get_base failed (%d)", err);
		return err;
	}

	per_ad = (struct bt_data)BT_DATA(BT_DATA_SVC_DATA16, base_buf.data, base_buf.len);
	err = bt_le_per_adv_set_data(adv, &per_ad, 1);
	if (err) {
		LOG_ERR("per_adv_set_data failed (%d)", err);
		return err;
	}

	err = bt_le_ext_adv_start(adv, BT_LE_EXT_ADV_START_DEFAULT);
	if (err) {
		LOG_ERR("ext_adv_start failed (%d)", err);
		return err;
	}

	err = bt_le_per_adv_start(adv);
	if (err) {
		LOG_ERR("per_adv_start failed (%d)", err);
		return err;
	}

	err = bt_bap_broadcast_source_start(broadcast_source, adv);
	if (err) {
		LOG_ERR("broadcast_source_start failed (%d)", err);
		return err;
	}

	LOG_INF("Advertising \"%s\", broadcast ID 0x%06x, %d Hz LC3, %u octets",
		CONFIG_BROADCAST_NAME, broadcast_id, LC3_RATE_HZ, preset.qos.sdu);
	return 0;
}

int role_run(void)
{
	int err;

	led_state_set(LED_STATE_SEARCHING);

	lc3_enc = lc3_setup_encoder(FRAME_US, LC3_RATE_HZ, PCM_RATE_HZ, &lc3_mem);
	if (lc3_enc == NULL) {
		LOG_ERR("LC3 encoder setup failed");
		return -EINVAL;
	}

	err = bt_enable(NULL);
	if (err) {
		LOG_ERR("bt_enable failed (%d)", err);
		return err;
	}

	err = bt_bap_broadcast_source_register_cb(&source_cb);
	if (err) {
		return err;
	}

	err = create_source();
	if (err) {
		LOG_ERR("broadcast_source_create failed (%d)", err);
		return err;
	}

	err = start_advertising();
	if (err) {
		return err;
	}

	k_sem_take(&sem_started, K_FOREVER);

	return audio_in_start();
}
```
