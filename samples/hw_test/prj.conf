## CMakeLists.txt
```
# Copyright (c) 2026 Troposound
# SPDX-License-Identifier: Apache-2.0

cmake_minimum_required(VERSION 3.20.0)
find_package(Zephyr REQUIRED HINTS $ENV{ZEPHYR_BASE})
project(hw_test)

target_sources(app PRIVATE src/main.c src/tests.c src/audio.c src/radio.c src/battery.c)
```

## sample.yaml
```
# Copyright (c) 2026 Troposound
# SPDX-License-Identifier: Apache-2.0

sample:
  name: Hardware test
  description: Board bring-up self-test for every peripheral on R1 and H1
common:
  sysbuild: true
  build_only: true
  integration_platforms:
    - h1/nrf5340/cpuapp
    - r1/nrf5340/cpuapp
tests:
  sample.troposound.hw_test:
    platform_allow:
      - h1/nrf5340/cpuapp
      - r1/nrf5340/cpuapp
```

## sysbuild.conf
```
# Copyright (c) 2026 Troposound
# SPDX-License-Identifier: Apache-2.0

SB_CONFIG_NETCORE_IPC_RADIO=y
SB_CONFIG_NETCORE_IPC_RADIO_BT_HCI_IPC=y
```

## prj.conf
```kconfig
# Copyright (c) 2026 Troposound
# SPDX-License-Identifier: Apache-2.0

CONFIG_I2C=y
CONFIG_INPUT=y
CONFIG_FPU=y
CONFIG_FPU_SHARING=y
CONFIG_FUEL_GAUGE=y

CONFIG_AUDIO=y
CONFIG_AUDIO_CODEC=y
CONFIG_TROPOSOUND_AUDIO_I2S=y

CONFIG_USB_DEVICE_STACK_NEXT=y
CONFIG_USBD_LOOPBACK_CLASS=y
CONFIG_UDC_BUF_POOL_SIZE=4096
CONFIG_USBD_LOG_LEVEL_WRN=y
CONFIG_UDC_DRIVER_LOG_LEVEL_WRN=y

CONFIG_BT=y
CONFIG_BT_OBSERVER=y
CONFIG_BT_BROADCASTER=y
CONFIG_BT_EXT_ADV=n

CONFIG_SHELL=y
CONFIG_SHELL_STACK_SIZE=4096
CONFIG_SHELL_PROMPT_UART="hw_test:~$ "
CONFIG_LOG=y
CONFIG_MAIN_STACK_SIZE=4096
CONFIG_LOG_PRINTK=n
CONFIG_LOG_BUFFER_SIZE=4096
# Logs straight to UART, so tests are not interleaved with shell prompts
CONFIG_SHELL_LOG_BACKEND=n
CONFIG_LOG_BACKEND_UART=y
```

## boards/h1_nrf5340_cpuapp.conf
```kconfig
# Copyright (c) 2026 Troposound
# SPDX-License-Identifier: Apache-2.0

CONFIG_SPI=y
CONFIG_SENSOR=y
CONFIG_BT_DEVICE_NAME="Troposound H1 HWTEST"
```

## boards/r1_nrf5340_cpuapp.conf
```kconfig
# Copyright (c) 2026 Troposound
# SPDX-License-Identifier: Apache-2.0

CONFIG_ADC=y
CONFIG_BT_DEVICE_NAME="Troposound R1 HWTEST"
```

## src/main.c
```c
/*
 * Copyright (c) 2026 Troposound
 *
 * SPDX-License-Identifier: Apache-2.0
 */

#include <ctype.h>
#include <stdarg.h>
#include <stdio.h>
#include <stdlib.h>
#include <string.h>

#include <zephyr/kernel.h>
#include <zephyr/drivers/gpio.h>
#include <zephyr/input/input.h>
#include <zephyr/shell/shell.h>
#include <zephyr/shell/shell_uart.h>
#include <zephyr/sys/printk.h>

#include "hw_test.h"

#define RUN_ALL -1

struct key_evt {
	uint16_t code;
	int32_t value;
};

K_MSGQ_DEFINE(key_q, sizeof(struct key_evt), 16, 4);
K_MSGQ_DEFINE(con_q, sizeof(uint8_t), 16, 1);
/* Test index or RUN_ALL; tests run in main so the shell thread can feed con_q */
K_MSGQ_DEFINE(run_q, sizeof(int), 4, 4);
K_MUTEX_DEFINE(hw_run_lock);

static const struct gpio_dt_spec led_r = GPIO_DT_SPEC_GET(DT_ALIAS(led0), gpios);
static const struct gpio_dt_spec led_g = GPIO_DT_SPEC_GET(DT_ALIAS(led1), gpios);

static const char *const verdicts[] = { "PASS", "WARN", "FAIL", "SKIP" };
static enum result results[32];
static char notes[32][96];
static size_t current;

bool hw_running_all;

void note(const char *fmt, ...)
{
	va_list ap;

	va_start(ap, fmt);
	vsnprintf(notes[current], sizeof(notes[current]), fmt, ap);
	va_end(ap);
	printk("    %s\n", notes[current]);
}

static void input_cb(struct input_event *evt, void *user_data)
{
	struct key_evt k = { .code = evt->code, .value = evt->value };

	ARG_UNUSED(user_data);

	if (evt->type == INPUT_EV_KEY) {
		(void)k_msgq_put(&key_q, &k, K_NO_WAIT);
	}
}
INPUT_CALLBACK_DEFINE(NULL, input_cb, NULL);

static void con_bypass(const struct shell *sh, uint8_t *data, size_t len, void *user_data)
{
	ARG_UNUSED(sh);
	ARG_UNUSED(user_data);

	for (size_t i = 0; i < len; i++) {
		(void)k_msgq_put(&con_q, &data[i], K_NO_WAIT);
	}
}

void key_flush(void)
{
	k_msgq_purge(&key_q);
	k_msgq_purge(&con_q);
}

int yn_wait(k_timeout_t timeout)
{
	k_timepoint_t end = sys_timepoint_calc(timeout);
	uint8_t c;

	while (k_msgq_get(&con_q, &c, sys_timepoint_timeout(end)) == 0) {
		c = tolower(c);
		if (c == 'y' || c == 'n') {
			return c == 'y';
		}
	}

	return -EAGAIN;
}

bool ask_yn(const char *question)
{
	bool yes;

	printk("    %s [y/n]\n", question);
	yes = yn_wait(K_FOREVER) == 1;
	printk("    %s\n", yes ? "yes" : "no");

	return yes;
}

bool said_no(void)
{
	return yn_wait(K_NO_WAIT) == 0;
}

int key_wait(int code, k_timeout_t timeout)
{
	k_timepoint_t end = sys_timepoint_calc(timeout);
	struct key_evt k;

	while (k_msgq_get(&key_q, &k, sys_timepoint_timeout(end)) == 0) {
		if (code < 0) {
			return k.value;
		}
		if (k.code == code && k.value) {
			return 1;
		}
	}

	return -EAGAIN;
}

static enum result run_one(size_t i)
{
	const struct hw_test *t = &hw_tests[i];

	current = i;
	notes[i][0] = '\0';
	printk("\n[%zu/%zu] %s: %s\n", i + 1, hw_tests_count, t->name, t->desc);
	key_flush();
	results[i] = t->run();
	printk("  -> %s\n", verdicts[results[i]]);

	return results[i];
}

static void summary(size_t first, size_t last)
{
	size_t n[4] = { 0 };

	printk("\n==== %s hardware test summary ====\n", CONFIG_BOARD);
	for (size_t i = first; i <= last; i++) {
		n[results[i]]++;
		printk("  %-4s  %-12s %s\n", verdicts[results[i]], hw_tests[i].name, notes[i]);
	}
	printk("==== %zu pass, %zu warn, %zu fail, %zu skip ====\n", n[PASS], n[WARN], n[FAIL],
	       n[SKIP]);
	printk("==== RESULT: %s ====\n", n[FAIL] > 0 ? "NO PASS" : "PASS");
	printk("Re-run: 'hw run' (all) or 'hw run <name>'; list: 'hw list'\n");

	gpio_pin_set_dt(&led_r, n[FAIL] > 0);
	gpio_pin_set_dt(&led_g, n[FAIL] == 0);
}

static void run(int idx)
{
	const struct shell *sh = shell_backend_uart_get_ptr();
	size_t first = (idx == RUN_ALL) ? 0 : idx;
	size_t last = (idx == RUN_ALL) ? hw_tests_count - 1 : idx;

	k_mutex_lock(&hw_run_lock, K_FOREVER);
	shell_set_bypass(sh, con_bypass, NULL);
	hw_running_all = (idx == RUN_ALL);
	for (size_t i = first; i <= last; i++) {
		run_one(i);
	}
	hw_running_all = false;
	summary(first, last);
	shell_set_bypass(sh, NULL, NULL);
	k_mutex_unlock(&hw_run_lock);
}

static int queue_run(const struct shell *sh, int idx)
{
	if (k_msgq_put(&run_q, &idx, K_NO_WAIT) != 0) {
		shell_error(sh, "Run queue full");
		return -EBUSY;
	}

	return 0;
}

static int cmd_list(const struct shell *sh, size_t argc, char **argv)
{
	ARG_UNUSED(argc);
	ARG_UNUSED(argv);

	for (size_t i = 0; i < hw_tests_count; i++) {
		shell_print(sh, "  %-12s %s", hw_tests[i].name, hw_tests[i].desc);
	}

	return 0;
}

static int cmd_run(const struct shell *sh, size_t argc, char **argv)
{
	if (argc < 2) {
		return queue_run(sh, RUN_ALL);
	}

	for (size_t i = 0; i < hw_tests_count; i++) {
		if (strcmp(argv[1], hw_tests[i].name) == 0) {
			return queue_run(sh, i);
		}
	}

	shell_error(sh, "Unknown test '%s', see 'hw list'", argv[1]);
	return -EINVAL;
}

#if DT_NODE_EXISTS(DT_ALIAS(charge_status))
static int cmd_battery(const struct shell *sh, size_t argc, char **argv)
{
	int seconds = (argc > 1) ? atoi(argv[1]) : 30;

	ARG_UNUSED(sh);

	k_mutex_lock(&hw_run_lock, K_FOREVER);
	hw_battery_monitor(CLAMP(seconds, 1, 3600));
	k_mutex_unlock(&hw_run_lock);

	return 0;
}
#endif

SHELL_STATIC_SUBCMD_SET_CREATE(hw_cmds,
	SHELL_CMD(list, NULL, "List tests", cmd_list),
	SHELL_CMD_ARG(run, NULL, "Run all tests, or one: run <name>", cmd_run, 1, 1),
#if DT_NODE_EXISTS(DT_ALIAS(charge_status))
	SHELL_CMD_ARG(battery, NULL, "USB, charger and gauge once per second: battery [s]",
		      cmd_battery, 1, 1),
#endif
	SHELL_SUBCMD_SET_END);
SHELL_CMD_REGISTER(hw, &hw_cmds, "Troposound hardware test", NULL);

int main(void)
{
	int idx;

	if (hw_tests_count > ARRAY_SIZE(results)) {
		printk("Test table larger than the result table\n");
		return 0;
	}

	printk("\n*** Troposound %s hardware test, %zu tests ***\n", CONFIG_BOARD, hw_tests_count);
	printk("Follow the prompts: answer y/n, or do the action (n if it does nothing).\n");
	k_msleep(1000);

	run(RUN_ALL);
	while (k_msgq_get(&run_q, &idx, K_FOREVER) == 0) {
		run(idx);
	}

	return 0;
}
```

## src/audio.c
```c
/*
 * Copyright (c) 2026 Troposound
 *
 * SPDX-License-Identifier: Apache-2.0
 */

#include <math.h>
#include <stdlib.h>

#include <zephyr/kernel.h>
#include <zephyr/audio/codec.h>
#include <zephyr/drivers/gpio.h>
#include <zephyr/sys/atomic.h>

#include <troposound/audio_i2s.h>

#include "hw_test.h"

#define USER_NODE   DT_PATH(zephyr_user)
#define CODEC_NODE  DT_COMPAT_GET_ANY_STATUS_OKAY(ti_tac5211)
#define TONE_PERIOD (AUDIO_I2S_SAMPLE_RATE_HZ / 1000) /* 1 kHz */
#define TONE_AMPL   8192.0f                           /* -12 dBFS */

BUILD_ASSERT(AUDIO_I2S_BLOCK_WORDS % TONE_PERIOD == 0, "block must hold whole 1 kHz periods");

#if DT_NODE_HAS_PROP(USER_NODE, amp_enable_gpios)
static const struct gpio_dt_spec amp_en = GPIO_DT_SPEC_GET(USER_NODE, amp_enable_gpios);
#endif

static const struct device *const codec = DEVICE_DT_GET(CODEC_NODE);

static uint32_t tx_buf[2][AUDIO_I2S_BLOCK_WORDS];
static uint32_t rx_buf[2][AUDIO_I2S_BLOCK_WORDS];
static int16_t tone[TONE_PERIOD];
static float goertzel_coeff;
static atomic_t mode = ATOMIC_INIT(AUDIO_SILENT);
static bool running;

/* Written from the I2S ISR */
static struct k_spinlock lock;
static uint32_t acc_blocks;
static uint32_t acc_peak;
static uint32_t acc_changes;
static double acc_energy;
static double acc_tone_power;

static int16_t sat16(int32_t v)
{
	return (int16_t)CLAMP(v, INT16_MIN, INT16_MAX);
}

/* Mic is on one slot, the other is silent; summing covers either */
static int16_t mic_sample(uint32_t word)
{
	return sat16((int16_t)(word & 0xFFFF) + (int16_t)(word >> 16));
}

static void measure_block(const uint32_t *rx)
{
	float s1 = 0.0f;
	float s2 = 0.0f;
	float energy = 0.0f;
	uint32_t peak = 0U;
	uint32_t changes = 0U;
	k_spinlock_key_t key;

	for (size_t i = 0; i < AUDIO_I2S_BLOCK_WORDS; i++) {
		int16_t m = mic_sample(rx[i]);
		float s0 = (float)m + goertzel_coeff * s1 - s2;

		s2 = s1;
		s1 = s0;
		energy += (float)m * m;
		peak = MAX(peak, (uint32_t)abs(m));
		changes += (i > 0 && rx[i] != rx[i - 1]);
	}

	key = k_spin_lock(&lock);
	acc_blocks++;
	acc_peak = MAX(acc_peak, peak);
	acc_changes += changes;
	acc_energy += (double)energy;
	acc_tone_power += (double)(s1 * s1 + s2 * s2 - goertzel_coeff * s1 * s2);
	k_spin_unlock(&lock, key);
}

static void fill_block(uint32_t *tx, const uint32_t *rx)
{
	static size_t phase;
	enum audio_mode m = (enum audio_mode)atomic_get(&mode);

	for (size_t i = 0; i < AUDIO_I2S_BLOCK_WORDS; i++) {
		int16_t s = 0;

		if (m == AUDIO_TONE) {
			s = tone[phase];
		} else if (m == AUDIO_LOOPBACK && rx != NULL) {
			s = mic_sample(rx[i]);
		}
		phase = (phase + 1) % TONE_PERIOD;
		tx[i] = ((uint32_t)(uint16_t)s << 16) | (uint16_t)s;
	}
}

static void i2s_cb(uint32_t *released_rx, const uint32_t *released_tx)
{
	uint32_t *tx = (uint32_t *)released_tx;
	uint32_t *rx = released_rx;

	if (rx == NULL || tx == NULL) {
		/* First request after start */
		tx = tx_buf[1];
		rx = rx_buf[1];
		fill_block(tx, NULL);
	} else {
		measure_block(rx);
		fill_block(tx, rx);
	}

	(void)audio_i2s_set_next_buf(tx, rx);
}

int hw_audio_start(int volume_half_db)
{
	struct audio_codec_cfg cfg = {
		.dai_type = AUDIO_DAI_TYPE_I2S,
		.dai_route = AUDIO_ROUTE_PLAYBACK_CAPTURE,
		.dai_cfg.i2s = {
			.word_size = 16,
			.channels = 2,
			.format = I2S_FMT_DATA_FORMAT_I2S,
			.frame_clk_freq = AUDIO_I2S_SAMPLE_RATE_HZ,
		},
	};
	audio_property_value_t vol = { .vol = volume_half_db };
	int err;

	if (running) {
		return -EALREADY;
	}

	if (!device_is_ready(codec)) {
		return -ENODEV;
	}

	for (size_t i = 0; i < TONE_PERIOD; i++) {
		tone[i] = (int16_t)(TONE_AMPL * sinf(2.0f * 3.14159265f * i / TONE_PERIOD));
	}
	goertzel_coeff = 2.0f * cosf(2.0f * 3.14159265f *
				     (AUDIO_I2S_BLOCK_WORDS / TONE_PERIOD) / AUDIO_I2S_BLOCK_WORDS);

	err = audio_i2s_init();
	if (err) {
		return err;
	}

	atomic_set(&mode, AUDIO_SILENT);
	audio_i2s_callback_set(i2s_cb);
	fill_block(tx_buf[0], NULL);
	err = audio_i2s_start(tx_buf[0], rx_buf[0]);
	if (err) {
		audio_i2s_uninit();
		return err;
	}

	/* Codec PLL locks to BCLK, so start I2S first */
	err = audio_codec_configure(codec, &cfg);
	if (err == 0) {
		err = audio_codec_set_property(codec, AUDIO_PROPERTY_OUTPUT_VOLUME,
					       AUDIO_CHANNEL_ALL, vol);
	}
	if (err) {
		audio_i2s_uninit();
		return err;
	}

#if DT_NODE_HAS_PROP(USER_NODE, amp_enable_gpios)
	gpio_pin_configure_dt(&amp_en, GPIO_OUTPUT_ACTIVE);
#endif

	(void)audio_i2s_late_count_reset();
	running = true;
	/* ADC high-pass settles in about 1 s at +30 dB gain */
	k_msleep(1200);

	return 0;
}

void hw_audio_stop(void)
{
	if (!running) {
		return;
	}

	atomic_set(&mode, AUDIO_SILENT);
	k_msleep(50);
	audio_i2s_uninit();
#if DT_NODE_HAS_PROP(USER_NODE, amp_enable_gpios)
	gpio_pin_set_dt(&amp_en, 0);
#endif
	running = false;
}

void hw_audio_mode(enum audio_mode m)
{
	atomic_set(&mode, m);
}

static int to_dbfs_x10(double amplitude)
{
	if (amplitude < 1.0) {
		return -999;
	}

	return (int)lround(200.0 * log10(amplitude / 32768.0));
}

void hw_audio_measure(int ms, struct audio_level *out)
{
	k_spinlock_key_t key;
	uint32_t blocks;

	k_msleep(50); /* skip the block in flight */

	key = k_spin_lock(&lock);
	acc_blocks = 0U;
	acc_peak = 0U;
	acc_changes = 0U;
	acc_energy = 0.0;
	acc_tone_power = 0.0;
	k_spin_unlock(&lock, key);

	k_msleep(ms);

	key = k_spin_lock(&lock);
	blocks = acc_blocks;
	out->blocks = blocks;
	out->peak = acc_peak;
	out->changes = acc_changes;
	if (blocks > 0U) {
		double n = (double)blocks * AUDIO_I2S_BLOCK_WORDS;
		double tone_power = acc_tone_power / blocks;

		out->rms_dbfs_x10 = to_dbfs_x10(sqrt(acc_energy / n));
		/* Goertzel power is (A * N / 2)^2; convert to RMS */
		out->tone_dbfs_x10 = to_dbfs_x10(2.0 * sqrt(MAX(tone_power, 0.0)) /
						 AUDIO_I2S_BLOCK_WORDS / sqrt(2.0));
	} else {
		out->rms_dbfs_x10 = -999;
		out->tone_dbfs_x10 = -999;
	}
	k_spin_unlock(&lock, key);
}
```

## src/battery.c
```c
/*
 * Copyright (c) 2026 Troposound
 *
 * SPDX-License-Identifier: Apache-2.0
 */

#include <stdlib.h>

#include <hal/nrf_usbreg.h>
#include <zephyr/kernel.h>
#include <zephyr/drivers/gpio.h>
#include <zephyr/drivers/i2c.h>
#include <zephyr/sys/byteorder.h>
#include <zephyr/sys/printk.h>

#include "hw_test.h"

#if DT_NODE_EXISTS(DT_ALIAS(charge_status))

/* Charging is disabled while the debugger connector is plugged in */

#define GAUGE_NODE DT_ALIAS(fuel_gauge0)

#define MAX17048_REG_VCELL 0x02
#define MAX17048_REG_SOC   0x04
#define MAX17048_REG_HIBRT 0x0A
#define MAX17048_REG_CRATE 0x16

#define CHARGE_SETTLE_MS 3000 /* charger soft start plus gauge samples */
#define CHARGE_RISE_MV   15   /* charge current x cell resistance, minimum */
/* Below the BQ24075 recharge threshold (4.2 V - ~100 mV) */
#define BATT_LOW_MV      4050

struct batt {
	bool vbus;
	bool charging; /* BQ24075 /CHG low */
	int mv;
	int soc_x10;   /* 0.1 % */
	int crate_x10; /* 0.1 %/h, positive while charging */
};

static const struct i2c_dt_spec gauge = I2C_DT_SPEC_GET(GAUGE_NODE);
static const struct gpio_dt_spec chg_pin = GPIO_DT_SPEC_GET(DT_ALIAS(charge_status), gpios);

static int gauge_read(uint8_t reg, uint16_t *val)
{
	uint8_t buf[2];
	int err = i2c_burst_read_dt(&gauge, reg, buf, sizeof(buf));

	if (err) {
		return err;
	}

	*val = sys_get_be16(buf);
	return 0;
}

/* Hibernate samples VCELL every 45 s; active mode every 250 ms */
static int gauge_hibernate_off(void)
{
	uint8_t buf[2] = { 0 };

	return i2c_burst_write_dt(&gauge, MAX17048_REG_HIBRT, buf, sizeof(buf));
}

static int vcell_mv(int *mv)
{
	uint16_t vcell;
	int err = gauge_read(MAX17048_REG_VCELL, &vcell);

	if (err) {
		return err;
	}

	*mv = (int)vcell * 5 / 64; /* 78.125 uV/LSB */
	return 0;
}

static int soc_x10(int *soc)
{
	uint16_t raw;
	int err = gauge_read(MAX17048_REG_SOC, &raw);

	if (err) {
		return err;
	}

	*soc = (int)raw * 10 / 256;
	return 0;
}

static bool vbus_present(void)
{
	return nrf_usbreg_status_get(NRF_USBREGULATOR) & NRF_USBREG_STATUS_VBUSDETECT_MASK;
}

static int batt_read(struct batt *b)
{
	uint16_t crate;
	int sum = 0;
	int err;

	b->vbus = vbus_present();
	b->charging = gpio_pin_get_dt(&chg_pin) == 1;

	for (int i = 0; i < 4; i++) {
		int mv;

		err = vcell_mv(&mv);
		if (err) {
			return err;
		}
		sum += mv;
		k_msleep(250);
	}
	b->mv = sum / 4;

	err = soc_x10(&b->soc_x10);
	err = err ? err : gauge_read(MAX17048_REG_CRATE, &crate);
	if (err) {
		return err;
	}

	b->crate_x10 = (int16_t)crate * 208 / 100; /* 0.208 %/h per LSB */
	return 0;
}

static void batt_print(const char *tag, const struct batt *b)
{
	printk("    %-8s USB %-3s  /CHG %-12s %4d mV  %3d.%d %%  %s%d.%d %%/h\n", tag,
	       b->vbus ? "in" : "out", b->charging ? "charging" : "not charging", b->mv,
	       b->soc_x10 / 10, b->soc_x10 % 10, b->crate_x10 < 0 ? "-" : "+",
	       abs(b->crate_x10) / 10, abs(b->crate_x10) % 10);
}

/* False when the operator pressed n instead */
static bool usb_wait_change(bool from)
{
	key_flush();
	while (!said_no()) {
		if (vbus_present() != from) {
			return true;
		}
		k_msleep(100);
	}
	return false;
}

/* Charge current shows as a VCELL step when the charger starts */
enum result test_charging(void)
{
	struct batt s[3];
	size_t n = 1;
	int rise = 0;
	bool idle_low = false;

	if (!gpio_is_ready_dt(&chg_pin) || gauge_hibernate_off() != 0 || batt_read(&s[0]) != 0) {
		note("MAX17048 or /CHG pin not accessible");
		return FAIL;
	}
	batt_print("now", &s[0]);

	while (n < ARRAY_SIZE(s)) {
		bool from = s[n - 1].vbus;

		printk("    %s the USB cable (board keeps running on battery; n to skip) ...\n",
		       from ? "Unplug" : "Plug in");
		if (!usb_wait_change(from)) {
			break;
		}
		k_msleep(CHARGE_SETTLE_MS);
		if (batt_read(&s[n]) != 0) {
			note("MAX17048 read failed");
			return FAIL;
		}
		batt_print(s[n].vbus ? "USB in" : "USB out", &s[n]);
		n++;
	}

	for (size_t i = 0; i < n; i++) {
		if (!s[i].vbus && s[i].charging) {
			note("/CHG says charging without USB power");
			return FAIL;
		}
		if (s[i].vbus && !s[i].charging && s[i].mv < BATT_LOW_MV) {
			idle_low = true;
		}
	}

	for (size_t i = 1; i < n; i++) {
		if (!s[i].vbus || !s[i].charging) {
			continue;
		}
		rise = s[i].mv - s[i - 1].mv;
		if (rise < CHARGE_RISE_MV) {
			note("charging, but battery rose only %d mV: no charge current", rise);
			return FAIL;
		}
	}

	if (rise > 0) {
		note("/CHG follows USB; charging lifts battery +%d mV (%d mV, %d %%)", rise,
		     s[n - 1].mv, s[n - 1].soc_x10 / 10);
		return PASS;
	}

	if (idle_low) {
		note("USB in, %d mV, charger off: debugger attached? Check with the charge LED",
		     s[n - 1].mv);
		return WARN;
	}

	if (n < ARRAY_SIZE(s)) {
		note("USB not %s, charging not proven: %d mV, %d %%, %s",
		     n == 1 ? "unplugged/plugged" : "plugged back", s[n - 1].mv,
		     s[n - 1].soc_x10 / 10, s[n - 1].charging ? "charging" : "not charging");
		return WARN;
	}

	note("battery near full (%d mV, %d %%): charger idle as expected, /CHG ok", s[n - 1].mv,
	     s[n - 1].soc_x10 / 10);
	return PASS;
}

void hw_battery_monitor(int seconds)
{
	struct batt b;

	if (gauge_hibernate_off() != 0) {
		printk("MAX17048 not accessible\n");
		return;
	}
	for (int i = 0; i < seconds; i++) {
		if (batt_read(&b) != 0) {
			printk("MAX17048 read failed\n");
			break;
		}
		batt_print("", &b);
		/* batt_read() takes 1 s */
	}
}

/* R1's charger drives its own charge LED */
#define HW_CHARGE_LED IS_ENABLED(CONFIG_BOARD_R1)

#define TICK_MS      250
#define SETTLE_TICKS (CHARGE_SETTLE_MS / TICK_MS)

enum ind {
	IND_NONE, /* LED owned by the tests */
	IND_BATTERY,
	IND_SETTLING,
	IND_CHARGING,
	IND_FAULT,
	IND_IDLE,
};

static const struct gpio_dt_spec led_r = GPIO_DT_SPEC_GET(DT_ALIAS(led0), gpios);
static const struct gpio_dt_spec led_g = GPIO_DT_SPEC_GET(DT_ALIAS(led1), gpios);
static const struct gpio_dt_spec led_b = GPIO_DT_SPEC_GET(DT_ALIAS(led2), gpios);

static void led_rgb(bool r, bool g, bool b)
{
	gpio_pin_set_dt(&led_r, r);
	gpio_pin_set_dt(&led_g, g);
	gpio_pin_set_dt(&led_b, b);
}

static void led_show(enum ind ind, uint32_t tick, int soc)
{
	bool flash = (tick % 8U) == 0U;

	switch (ind) {
	case IND_BATTERY:
		led_rgb(flash && soc < 500, flash && soc >= 200, false);
		break;
	case IND_CHARGING:
		led_rgb(false, false, !HW_CHARGE_LED && (tick / 2U) % 2U == 0U);
		break;
	case IND_FAULT:
		led_rgb(tick % 2U == 0U, false, false);
		break;
	case IND_SETTLING:
	case IND_IDLE:
		led_rgb(false, false, !HW_CHARGE_LED);
		break;
	default:
		break;
	}
}

static void charge_led_thread(void *p1, void *p2, void *p3)
{
	enum ind ind = IND_NONE;
	bool vbus = vbus_present();
	bool chg = false;
	bool paused = false;
	int mv[4];
	int base_mv = 0;
	int settle = 0;
	int soc = 0;
	uint32_t tick = 0U;

	ARG_UNUSED(p1);
	ARG_UNUSED(p2);
	ARG_UNUSED(p3);

	if (!gpio_is_ready_dt(&chg_pin) || !gpio_is_ready_dt(&led_r) ||
	    gauge_hibernate_off() != 0 || vcell_mv(&mv[0]) != 0) {
		printk("charge LED: gauge or GPIO not ready, disabled\n");
		return;
	}
	for (size_t i = 1; i < ARRAY_SIZE(mv); i++) {
		mv[i] = mv[0];
	}
	gpio_pin_configure_dt(&led_r, GPIO_OUTPUT_INACTIVE);
	gpio_pin_configure_dt(&led_g, GPIO_OUTPUT_INACTIVE);
	gpio_pin_configure_dt(&led_b, GPIO_OUTPUT_INACTIVE);
	chg = gpio_pin_get_dt(&chg_pin) == 1;

	for (;; k_msleep(TICK_MS), tick++) {
		int before = (mv[0] + mv[1] + mv[2] + mv[3]) / 4;
		bool vbus_now;
		bool chg_now;
		int v;

		/* Tests own the LED and the USB cable */
		if (k_mutex_lock(&hw_run_lock, K_NO_WAIT) != 0) {
			ind = IND_NONE;
			paused = true;
			continue;
		}

		vbus_now = vbus_present();
		chg_now = gpio_pin_get_dt(&chg_pin) == 1;
		if (vcell_mv(&v) == 0) {
			mv[tick % ARRAY_SIZE(mv)] = v;
		}
		(void)soc_x10(&soc);
		k_mutex_unlock(&hw_run_lock);

		if (paused) {
			paused = false;
			vbus = vbus_now;
			chg = chg_now;
			continue;
		}

		if (vbus_now == vbus && chg_now == chg) {
			if (ind == IND_SETTLING && --settle == 0) {
				int rise = (mv[0] + mv[1] + mv[2] + mv[3]) / 4 - base_mv;

				ind = rise >= CHARGE_RISE_MV ? IND_CHARGING : IND_FAULT;
				printk("charge LED: charging, battery %+d mV -> %s\n", rise,
				       ind == IND_CHARGING ? "ok" : "FAULT, no charge current");
			}
		} else if (chg_now && !vbus_now) {
			ind = IND_FAULT;
			printk("charge LED: /CHG active without USB -> FAULT\n");
		} else if (chg_now && !chg) {
			base_mv = before;
			settle = SETTLE_TICKS;
			ind = IND_SETTLING;
		} else if (!chg_now) {
			ind = vbus_now ? IND_IDLE : IND_BATTERY;
			printk("charge LED: USB %s, charger off, %d mV, %d %%\n",
			       vbus_now ? "in" : "out", before, soc / 10);
		}
		vbus = vbus_now;
		chg = chg_now;

		led_show(ind, tick, soc);
	}
}

K_THREAD_DEFINE(charge_led, 1024, charge_led_thread, NULL, NULL, NULL, 10, 0, 0);

#endif /* DT_NODE_EXISTS(DT_ALIAS(charge_status)) */
```

## src/hw_test.h
```c
/*
 * Copyright (c) 2026 Troposound
 *
 * SPDX-License-Identifier: Apache-2.0
 */

#ifndef HW_TEST_H_
#define HW_TEST_H_

#include <stdbool.h>
#include <stddef.h>
#include <stdint.h>

#include <zephyr/kernel.h>

enum result {
	PASS,
	WARN,
	FAIL,
	SKIP,
};

struct hw_test {
	const char *name;
	const char *desc;
	enum result (*run)(void);
};

void note(const char *fmt, ...);

/* code < 0 matches any event; returns the event value or -EAGAIN */
int key_wait(int code, k_timeout_t timeout);
void key_flush(void);

/* Console y/n: 1 yes, 0 no, -EAGAIN on timeout */
int yn_wait(k_timeout_t timeout);
bool ask_yn(const char *question);
bool said_no(void);

/* Set during 'hw run'; power-off tests only run when named */
extern bool hw_running_all;

enum audio_mode {
	AUDIO_SILENT,
	AUDIO_TONE,     /* 1 kHz, -12 dBFS */
	AUDIO_LOOPBACK,
};

struct audio_level {
	uint32_t blocks;
	uint32_t peak;
	uint32_t changes;   /* 0 = no data on SDIN */
	int rms_dbfs_x10;
	int tone_dbfs_x10;  /* 1 kHz bin */
};

int hw_audio_start(int volume_half_db);
void hw_audio_stop(void);
void hw_audio_mode(enum audio_mode m);
void hw_audio_measure(int ms, struct audio_level *out);

int radio_enable(void);
void radio_idle(void);
int radio_busy(void);
int radio_advertise(void);

extern const struct hw_test hw_tests[];
extern const size_t hw_tests_count;

enum result test_radio(void);
enum result test_rf_audio(void);

/* Held while tests run; the charge LED indicator backs off meanwhile */
extern struct k_mutex hw_run_lock;

enum result test_charging(void);
void hw_battery_monitor(int seconds);

#endif /* HW_TEST_H_ */
```

## src/radio.c
```c
/*
 * Copyright (c) 2026 Troposound
 *
 * SPDX-License-Identifier: Apache-2.0
 */

#include <stdio.h>
#include <stdlib.h>

#include <zephyr/bluetooth/bluetooth.h>
#include <zephyr/sys/printk.h>

#include "hw_test.h"

#define SCAN_MS  4000
#define MAX_SEEN 32

/* 20 ms advertising + 100% scan duty keeps the nRF21540 toggling PA/LNA */
#define BUSY_ADV_PARAM  BT_LE_ADV_PARAM(BT_LE_ADV_OPT_USE_IDENTITY, 0x0020, 0x0020, NULL)
#define BUSY_SCAN_PARAM BT_LE_SCAN_PARAM(BT_LE_SCAN_TYPE_PASSIVE, BT_LE_SCAN_OPT_NONE, 0x0010, 0x0010)

static bt_addr_le_t seen[MAX_SEEN];
static size_t seen_count;
static int8_t best_rssi;

static const struct bt_data ad[] = {
	BT_DATA_BYTES(BT_DATA_FLAGS, BT_LE_AD_NO_BREDR),
	BT_DATA(BT_DATA_NAME_COMPLETE, CONFIG_BT_DEVICE_NAME, sizeof(CONFIG_BT_DEVICE_NAME) - 1),
};

static void scan_cb(const bt_addr_le_t *addr, int8_t rssi, uint8_t type,
		    struct net_buf_simple *buf)
{
	ARG_UNUSED(type);
	ARG_UNUSED(buf);

	if (seen_count == 0U || rssi > best_rssi) {
		best_rssi = rssi;
	}

	for (size_t i = 0; i < seen_count; i++) {
		if (bt_addr_le_eq(&seen[i], addr)) {
			return;
		}
	}

	if (seen_count < MAX_SEEN) {
		bt_addr_le_copy(&seen[seen_count++], addr);
	}
}

int radio_enable(void)
{
	static bool enabled;
	int err;

	if (enabled) {
		return 0;
	}

	err = bt_enable(NULL);
	if (err == 0) {
		enabled = true;
	}

	return err;
}

void radio_idle(void)
{
	(void)bt_le_adv_stop();
	(void)bt_le_scan_stop();
}

int radio_advertise(void)
{
	radio_idle();

	return bt_le_adv_start(BT_LE_ADV_NCONN_IDENTITY, ad, ARRAY_SIZE(ad), NULL, 0);
}

int radio_busy(void)
{
	int err;

	radio_idle();

	err = bt_le_adv_start(BUSY_ADV_PARAM, ad, ARRAY_SIZE(ad), NULL, 0);
	if (err) {
		return err;
	}

	seen_count = 0U;
	return bt_le_scan_start(BUSY_SCAN_PARAM, scan_cb);
}

enum result test_radio(void)
{
	int err;

	err = radio_enable();
	if (err) {
		note("bt_enable failed (%d): net core / IPC down", err);
		return FAIL;
	}

	radio_idle();
	seen_count = 0U;
	err = bt_le_scan_start(BT_LE_SCAN_PASSIVE, scan_cb);
	if (err) {
		note("scan start failed (%d)", err);
		return FAIL;
	}
	k_msleep(SCAN_MS);
	bt_le_scan_stop();

	err = radio_advertise();
	if (err) {
		note("advertising failed (%d)", err);
		return FAIL;
	}

	if (seen_count == 0U) {
		note("no advertisers heard in %d s; advertising '%s'", SCAN_MS / 1000,
		     CONFIG_BT_DEVICE_NAME);
		return WARN;
	}

	note("%zu devices heard, best RSSI %d dBm; advertising '%s'", seen_count, best_rssi,
	     CONFIG_BT_DEVICE_NAME);
	return PASS;
}

#define RF_LOOP_VOLUME (-40) /* -20 dB, avoids acoustic feedback on R1 */

/* Handles -0.x, which plain %d.%d would lose the sign of */
static const char *db(int x10, char buf[16])
{
	snprintf(buf, 16, "%s%d.%d", x10 < 0 ? "-" : "", abs(x10) / 10, abs(x10) % 10);
	return buf;
}

enum result test_rf_audio(void)
{
	char b1[16];
	char b2[16];
	char b3[16];
	struct audio_level quiet;
	struct audio_level busy;
	struct audio_level quiet2;
	enum result r = PASS;
	bool clean;
	int delta;
	int err;

	err = radio_enable();
	if (err) {
		note("bt_enable failed (%d)", err);
		return FAIL;
	}

	err = hw_audio_start(RF_LOOP_VOLUME);
	if (err) {
		note("audio start failed (%d)", err);
		return FAIL;
	}

	printk("    Keep quiet for 6 s: mic noise with radio off, on, off ...\n");
	radio_idle();
	hw_audio_measure(2000, &quiet);

	err = radio_busy();
	if (err) {
		note("radio busy mode failed (%d)", err);
		hw_audio_stop();
		radio_idle();
		return FAIL;
	}
	hw_audio_measure(2000, &busy);

	/* Quieter idle window, so drift can't hide RF noise */
	radio_idle();
	hw_audio_measure(2000, &quiet2);
	quiet.rms_dbfs_x10 = MIN(quiet.rms_dbfs_x10, quiet2.rms_dbfs_x10);

	err = radio_busy();
	if (err) {
		note("radio busy mode failed (%d)", err);
		hw_audio_stop();
		radio_idle();
		return FAIL;
	}

	delta = busy.rms_dbfs_x10 - quiet.rms_dbfs_x10;
	if (delta >= 30) {
		r = WARN;
	}

	printk("    Mic noise radio off %s dBFS, radio on %s dBFS\n", db(quiet.rms_dbfs_x10, b1),
	       db(busy.rms_dbfs_x10, b2));
	printk("    LISTEN: mic -> speaker/headphones while the radio transmits at 20 dBm.\n"
	       "    Talk, then stay silent and listen for buzz/hum. (Headphones on R1 if it howls.)\n");
	hw_audio_mode(AUDIO_LOOPBACK);
	key_flush();
	clean = ask_yn("Your voice comes through and there is no buzz/hum?");

	hw_audio_stop();
	(void)radio_advertise();

	note("mic noise %s%s dB with radio busy (%s -> %s dBFS); %s", delta >= 0 ? "+" : "",
	     db(delta, b3), db(quiet.rms_dbfs_x10, b1), db(busy.rms_dbfs_x10, b2),
	     clean ? "sounds clean" : "NOT clean");
	return clean ? r : FAIL;
}
```

## src/tests.c
```c
/*
 * Copyright (c) 2026 Troposound
 *
 * SPDX-License-Identifier: Apache-2.0
 */

#include <stdio.h>
#include <stdlib.h>
#include <string.h>

#include <hal/nrf_clock.h>
#include <hal/nrf_usbreg.h>
#include <zephyr/kernel.h>
#include <zephyr/drivers/adc.h>
#include <zephyr/drivers/clock_control/nrf_clock_control.h>
#include <zephyr/drivers/fuel_gauge.h>
#include <zephyr/drivers/gpio.h>
#include <zephyr/drivers/i2c.h>
#include <zephyr/drivers/sensor.h>
#include <zephyr/drivers/spi.h>
#include <zephyr/sys/byteorder.h>
#include <zephyr/sys/onoff.h>
#include <zephyr/sys/printk.h>
#include <zephyr/usb/usbd.h>
#include <zephyr/usb/usbd_msg.h>

#include <troposound/audio_i2s.h>

#include "hw_test.h"

#define USER_NODE    DT_PATH(zephyr_user)
#define CODEC_NODE   DT_COMPAT_GET_ANY_STATUS_OKAY(ti_tac5211)
#define GAUGE_NODE   DT_ALIAS(fuel_gauge0)

static const struct gpio_dt_spec leds[] = {
	GPIO_DT_SPEC_GET(DT_ALIAS(led0), gpios),
	GPIO_DT_SPEC_GET(DT_ALIAS(led1), gpios),
	GPIO_DT_SPEC_GET(DT_ALIAS(led2), gpios),
};

static enum result test_leds(void)
{
	static const char *const names[] = { "red", "green", "blue" };
	int ans = -EAGAIN;

	for (size_t i = 0; i < ARRAY_SIZE(leds); i++) {
		if (!gpio_is_ready_dt(&leds[i]) ||
		    gpio_pin_configure_dt(&leds[i], GPIO_OUTPUT_INACTIVE) < 0) {
			note("LED %s: GPIO not ready", names[i]);
			return FAIL;
		}
	}

	printk("    The RGB LED cycles red, green, blue, white. All four correct? [y/n]\n");
	key_flush();
	/* Last step lights all three: white */
	for (size_t step = 0; ans < 0; step = (step + 1) % (ARRAY_SIZE(leds) + 1)) {
		for (size_t i = 0; i < ARRAY_SIZE(leds); i++) {
			gpio_pin_set_dt(&leds[i], step == i || step == ARRAY_SIZE(leds));
		}
		ans = yn_wait(K_MSEC(700));
	}
	for (size_t i = 0; i < ARRAY_SIZE(leds); i++) {
		gpio_pin_set_dt(&leds[i], 0);
	}

	note("operator: red, green, blue, white %s", ans ? "ok" : "NOT ok");
	return ans ? PASS : FAIL;
}

static enum result test_clocks(void)
{
	struct onoff_manager *hf = z_nrf_clock_control_get_onoff(CLOCK_CONTROL_NRF_SUBSYS_HF);
	struct onoff_client cli;
	nrf_clock_lfclk_t lf_src;
	nrf_clock_hfclk_t hf_src = NRF_CLOCK_HFCLK_LOW_ACCURACY;
	bool hf_ok = false;
	int err;

	z_nrf_clock_control_lf_on(CLOCK_CONTROL_NRF_LF_START_STABLE);
	if (!nrf_clock_is_running(NRF_CLOCK, NRF_CLOCK_DOMAIN_LFCLK, &lf_src) ||
	    lf_src != NRF_CLOCK_LFCLK_XTAL) {
		note("32.768 kHz LFXO not running (src %d)", (int)lf_src);
		return FAIL;
	}

	sys_notify_init_spinwait(&cli.notify);
	err = onoff_request(hf, &cli);
	if (err < 0) {
		note("HFXO request failed (%d)", err);
		return FAIL;
	}

	for (int i = 0; i < 100 && !hf_ok; i++) {
		hf_ok = nrf_clock_is_running(NRF_CLOCK, NRF_CLOCK_DOMAIN_HFCLK, &hf_src) &&
			hf_src == NRF_CLOCK_HFCLK_HIGH_ACCURACY;
		k_msleep(1);
	}
	onoff_release(hf);

	if (!hf_ok) {
		note("32 MHz HFXO did not start");
		return FAIL;
	}

	note("LFXO 32.768 kHz and HFXO 32 MHz running");
	return PASS;
}

#define MAX17048_REG_VERSION 0x08

static enum result test_i2c(void)
{
	const struct i2c_dt_spec codec = I2C_DT_SPEC_GET(CODEC_NODE);
	const struct i2c_dt_spec gauge = I2C_DT_SPEC_GET(GAUGE_NODE);
	uint8_t page;
	uint8_t ver[2];
	enum result r = PASS;
	char codec_txt[24];
	char gauge_txt[24];

	if (i2c_reg_read_byte_dt(&codec, 0x00, &page) == 0) {
		snprintf(codec_txt, sizeof(codec_txt), "ok (page %u)", page);
	} else {
		snprintf(codec_txt, sizeof(codec_txt), "NO ACK");
		r = FAIL;
	}

	if (i2c_burst_read_dt(&gauge, MAX17048_REG_VERSION, ver, sizeof(ver)) == 0) {
		uint16_t v = sys_get_be16(ver);

		snprintf(gauge_txt, sizeof(gauge_txt), "ok (ver 0x%04x)", v);
		if ((v & 0xFFF0) != 0x0010) {
			r = FAIL;
		}
	} else {
		snprintf(gauge_txt, sizeof(gauge_txt), "NO ACK");
		r = FAIL;
	}

	note("TAC5211@0x%02x %s, MAX17048@0x%02x %s", codec.addr, codec_txt, gauge.addr,
	     gauge_txt);
	return r;
}

static enum result test_fuel_gauge(void)
{
	const struct device *gauge = DEVICE_DT_GET(GAUGE_NODE);
	union fuel_gauge_prop_val volt;
	union fuel_gauge_prop_val soc;

	if (!device_is_ready(gauge)) {
		note("MAX17048 driver not ready");
		return FAIL;
	}

	if (fuel_gauge_get_prop(gauge, FUEL_GAUGE_VOLTAGE, &volt) < 0 ||
	    fuel_gauge_get_prop(gauge, FUEL_GAUGE_RELATIVE_STATE_OF_CHARGE, &soc) < 0) {
		note("property read failed");
		return FAIL;
	}

	note("battery %d mV, %u %%", volt.voltage / 1000, soc.relative_state_of_charge);

	if (volt.voltage < 3000000 || volt.voltage > 4500000) {
		return WARN;
	}

	return PASS;
}

static enum result test_audio(void)
{
	struct audio_level quiet;
	struct audio_level loud;
	uint32_t expect = (2000U * (AUDIO_I2S_SAMPLE_RATE_HZ / 1000U)) / AUDIO_I2S_BLOCK_WORDS;
	uint32_t late;
	bool heard;
	int rise;
	int err;

	err = hw_audio_start(-24); /* -12 dB */
	if (err) {
		note("I2S/TAC5211 start failed (%d)", err);
		return FAIL;
	}

	printk("    Measuring: 2 s silence, then 1 kHz tone on speaker/headphones\n");
	hw_audio_mode(AUDIO_SILENT);
	hw_audio_measure(2000, &quiet);
	hw_audio_mode(AUDIO_TONE);
	hw_audio_measure(2000, &loud);
	late = audio_i2s_late_count_reset();
	key_flush();
	heard = ask_yn("Do you hear a steady 1 kHz tone?");
	hw_audio_stop();

	if (quiet.blocks < expect * 9U / 10U || quiet.blocks > expect * 11U / 10U) {
		note("I2S ran %u blocks in 2 s, expected %u (LRCK not 48 kHz?)", quiet.blocks,
		     expect);
		return FAIL;
	}

	if (quiet.changes == 0U && loud.changes == 0U) {
		note("mic data constant: no capture on SDIN");
		return FAIL;
	}

	/* Acoustic path; headset ear cups may keep the tone from the mic */
	rise = (loud.tone_dbfs_x10 - quiet.tone_dbfs_x10) / 10;
	note("%s; mic %d dBFS; 1 kHz at mic %d -> %d dBFS (%+d dB); late %u",
	     heard ? "tone heard" : "tone NOT heard", quiet.rms_dbfs_x10 / 10,
	     quiet.tone_dbfs_x10 / 10, loud.tone_dbfs_x10 / 10, rise, late);

	if (!heard) {
		return FAIL;
	}

	if (rise < 10) {
		return WARN; /* heard, but the mic did not pick it up */
	}

	return late ? WARN : PASS;
}

#define TAC5211_REG_PAGE        0x00
#define TAC5211_REG_GPO1_CFG0   0x0C
#define TAC5211_REG_GPI_CFG     0x0D
#define TAC5211_REG_GPO_GPI_VAL 0x0E
#define TAC5211_GPO1_GPO_PUSHPULL 0x21 /* GPO1_CFG = GPO, drive low and high */
#define TAC5211_GPI1_EN           BIT(1)
#define TAC5211_GPO1_VAL          BIT(5)
#define TAC5211_GPI1_MON          BIT(1)

static enum result test_codec_gpio(void)
{
	const struct i2c_dt_spec codec = I2C_DT_SPEC_GET(CODEC_NODE);
	const struct gpio_dt_spec gpo1 = GPIO_DT_SPEC_GET(USER_NODE, codec_gpo1_gpios);
	const struct gpio_dt_spec gpi1 = GPIO_DT_SPEC_GET(USER_NODE, codec_gpi1_gpios);
	int gpo_seen[2];
	int gpi_seen[2];
	uint8_t val;
	int err;

	err = i2c_reg_write_byte_dt(&codec, TAC5211_REG_PAGE, 0);
	err = err ? err : i2c_reg_write_byte_dt(&codec, TAC5211_REG_GPO1_CFG0,
						 TAC5211_GPO1_GPO_PUSHPULL);
	err = err ? err : i2c_reg_write_byte_dt(&codec, TAC5211_REG_GPI_CFG, TAC5211_GPI1_EN);
	if (err) {
		note("codec I2C write failed (%d)", err);
		return FAIL;
	}

	/* Pull against the driven level so an open line reads wrong */
	for (int level = 0; level <= 1; level++) {
		err = i2c_reg_update_byte_dt(&codec, TAC5211_REG_GPO_GPI_VAL, TAC5211_GPO1_VAL,
					     level ? TAC5211_GPO1_VAL : 0);
		gpio_pin_configure_dt(&gpo1, GPIO_INPUT | (level ? GPIO_PULL_DOWN : GPIO_PULL_UP));
		k_msleep(2);
		gpo_seen[level] = err ? -1 : gpio_pin_get_dt(&gpo1);
	}

	for (int level = 0; level <= 1; level++) {
		gpio_pin_configure_dt(&gpi1, level ? GPIO_OUTPUT_ACTIVE : GPIO_OUTPUT_INACTIVE);
		k_msleep(2);
		err = i2c_reg_read_byte_dt(&codec, TAC5211_REG_GPO_GPI_VAL, &val);
		gpi_seen[level] = err ? -1 : !!(val & TAC5211_GPI1_MON);
	}

	(void)i2c_reg_write_byte_dt(&codec, TAC5211_REG_GPO1_CFG0, 0);
	(void)i2c_reg_write_byte_dt(&codec, TAC5211_REG_GPI_CFG, 0);
	(void)i2c_reg_update_byte_dt(&codec, TAC5211_REG_GPO_GPI_VAL, TAC5211_GPO1_VAL, 0);
	gpio_pin_configure_dt(&gpo1, GPIO_INPUT);
	gpio_pin_configure_dt(&gpi1, GPIO_INPUT);

	note("GPO1->P%d.%02d read %d/%d, P%d.%02d->GPI1 read %d/%d (want 0/1)",
	     gpo1.port == DEVICE_DT_GET(DT_NODELABEL(gpio1)), gpo1.pin, gpo_seen[0], gpo_seen[1],
	     gpi1.port == DEVICE_DT_GET(DT_NODELABEL(gpio1)), gpi1.pin, gpi_seen[0], gpi_seen[1]);

	return (gpo_seen[0] == 0 && gpo_seen[1] == 1 && gpi_seen[0] == 0 && gpi_seen[1] == 1)
		       ? PASS
		       : FAIL;
}

USBD_DEVICE_DEFINE(hw_usbd, DEVICE_DT_GET(DT_NODELABEL(zephyr_udc0)), 0x1915, 0x5310);
USBD_DESC_LANG_DEFINE(usb_lang);
USBD_DESC_MANUFACTURER_DEFINE(usb_mfr, "Troposound");
USBD_DESC_PRODUCT_DEFINE(usb_product, CONFIG_BT_DEVICE_NAME);
USBD_CONFIGURATION_DEFINE(usb_fs_config, 0, 100, NULL);

static K_SEM_DEFINE(usb_configured, 0, 1);

static void usb_msg_cb(struct usbd_context *const ctx, const struct usbd_msg *const msg)
{
	if (msg->type == USBD_MSG_CONFIGURATION) {
		k_sem_give(&usb_configured);
	} else if (msg->type == USBD_MSG_VBUS_READY) {
		(void)usbd_enable(ctx);
	} else if (msg->type == USBD_MSG_VBUS_REMOVED) {
		(void)usbd_disable(ctx);
	}
}

static int usb_init_once(void)
{
	static int ret = 1;

	if (ret <= 0) {
		return ret;
	}

	ret = usbd_add_descriptor(&hw_usbd, &usb_lang);
	ret = ret ? ret : usbd_add_descriptor(&hw_usbd, &usb_mfr);
	ret = ret ? ret : usbd_add_descriptor(&hw_usbd, &usb_product);
	ret = ret ? ret : usbd_add_configuration(&hw_usbd, USBD_SPEED_FS, &usb_fs_config);
	ret = ret ? ret : usbd_register_all_classes(&hw_usbd, USBD_SPEED_FS, 1, NULL);
	ret = ret ? ret : usbd_msg_register_cb(&hw_usbd, usb_msg_cb);
	ret = ret ? ret : usbd_init(&hw_usbd);
	if (ret == 0 && nrf_usbreg_status_get(NRF_USBREGULATOR) & NRF_USBREG_STATUS_VBUSDETECT_MASK) {
		/* VBUS was present before the callback was registered */
		(void)usbd_enable(&hw_usbd);
	}

	return ret;
}

static enum result test_usb(void)
{
	bool vbus = nrf_usbreg_status_get(NRF_USBREGULATOR) & NRF_USBREG_STATUS_VBUSDETECT_MASK;
	int err;

	if (!vbus) {
		note("no VBUS: connect the board's USB port and re-run 'hw run usb'");
		return WARN;
	}

	err = usb_init_once();
	if (err) {
		note("USB device stack init failed (%d)", err);
		return FAIL;
	}

	if (k_sem_take(&usb_configured, K_SECONDS(2)) != 0) {
		printk("    Waiting for a host to enumerate the board (n to give up) ...\n");
		key_flush();
		while (k_sem_take(&usb_configured, K_MSEC(100)) != 0) {
			if (said_no()) {
				note("VBUS ok, but no host enumerated the board (D+/D-, cable, hub)");
				return FAIL;
			}
		}
	}
	k_sem_give(&usb_configured); /* stays configured for re-runs */

	note("VBUS ok, enumerated and configured by the host");
	return PASS;
}

struct button {
	uint16_t code;
	const char *label;
};

#define BUTTON_ENTRY(n) { DT_PROP(n, zephyr_code), DT_PROP(n, label) },

static const struct button buttons[] = {
	DT_FOREACH_CHILD(DT_PATH(buttons), BUTTON_ENTRY)
};

static enum result test_buttons(void)
{
	enum result r = PASS;
	char missed[48] = "";

	for (size_t i = 0; i < ARRAY_SIZE(buttons); i++) {
		bool no = false;

		printk("    Press %s (n if nothing happens) ...\n", buttons[i].label);
		key_flush();
		while (!no && key_wait(buttons[i].code, K_MSEC(20)) < 0) {
			no = said_no();
		}
		if (no) {
			printk("    %s: not detected\n", buttons[i].label);
			strncat(missed, buttons[i].label, sizeof(missed) - strlen(missed) - 2);
			strcat(missed, " ");
			r = FAIL;
		} else {
			printk("    %s: ok\n", buttons[i].label);
		}
	}

	if (r == PASS) {
		note("all %zu buttons pressed", ARRAY_SIZE(buttons));
	} else {
		note("not pressed: %s", missed);
	}

	return r;
}

#if DT_NODE_HAS_PROP(USER_NODE, io_channels)
static enum result test_pot(void)
{
	const struct adc_dt_spec pot = ADC_DT_SPEC_GET_BY_NAME(USER_NODE, volume_pot);
	const int full = BIT(pot.resolution) - 1;
	struct adc_sequence seq = { 0 };
	int16_t raw;
	int lo = INT16_MAX;
	int hi = INT16_MIN;

	if (!adc_is_ready_dt(&pot) || adc_channel_setup_dt(&pot) < 0) {
		note("ADC not ready");
		return FAIL;
	}
	adc_sequence_init_dt(&pot, &seq);
	seq.buffer = &raw;
	seq.buffer_size = sizeof(raw);

	printk("    Turn the volume knob fully down and fully up (n if it does nothing) ...\n");
	key_flush();
	while (!said_no()) {
		if (adc_read_dt(&pot, &seq) < 0) {
			note("ADC read failed");
			return FAIL;
		}
		lo = MIN(lo, MAX(raw, 0));
		hi = MAX(hi, MIN(raw, full));
		if (hi - lo > full * 7 / 10) {
			break;
		}
		k_msleep(20);
	}

	note("pot range %d..%d of %d (%d%%)", lo, hi, full, ((hi - lo) * 100) / full);

	return (hi - lo > full * 7 / 10) ? PASS : FAIL;
}
#endif

#if DT_NODE_EXISTS(DT_ALIAS(jack_detect))
static enum result test_switch(const struct gpio_dt_spec *pin, const char *what,
			       const char *action, enum result on_no)
{
	int before = gpio_pin_get_dt(pin);

	printk("    %s now %s. %s (n if nothing happens) ...\n", what,
	       before ? "ACTIVE" : "inactive", action);
	key_flush();
	while (gpio_pin_get_dt(pin) == before) {
		if (said_no()) {
			note("%s stayed %s", what, before ? "active" : "inactive");
			return on_no;
		}
		k_msleep(20);
	}

	note("%s changed %s -> %s", what, before ? "active" : "inactive",
	     before ? "inactive" : "active");
	return PASS;
}

static enum result test_jack(void)
{
	static const struct gpio_dt_spec pin = GPIO_DT_SPEC_GET(DT_ALIAS(jack_detect), gpios);

	return test_switch(&pin, "Headphone jack", "Plug in or pull out headphones",
			   FAIL);
}
#endif

#if DT_NODE_EXISTS(DT_ALIAS(fuel_gauge_alert))
static enum result test_gauge_alert(void)
{
	static const struct gpio_dt_spec pin =
		GPIO_DT_SPEC_GET(DT_ALIAS(fuel_gauge_alert), gpios);
	int v = gpio_pin_get_dt(&pin);

	if (v < 0) {
		note("alert pin read failed (%d)", v);
		return FAIL;
	}

	note("ALRT pin %s", v ? "ACTIVE (low battery / SoC alert latched)" : "idle");
	return v ? WARN : PASS;
}
#endif

#if DT_NODE_EXISTS(DT_ALIAS(qdec0))
static enum result test_encoder(void)
{
	const struct device *qdec = DEVICE_DT_GET(DT_ALIAS(qdec0));
	struct sensor_value rot;
	bool left = false;
	bool right = false;

	if (!device_is_ready(qdec)) {
		note("QDEC not ready");
		return FAIL;
	}

	(void)sensor_sample_fetch(qdec); /* drop stale count */
	printk("    Turn the encoder left and right (n if nothing happens) ...\n");
	key_flush();
	while (!(left && right) && !said_no()) {
		if (sensor_sample_fetch(qdec) == 0 &&
		    sensor_channel_get(qdec, SENSOR_CHAN_ROTATION, &rot) == 0) {
			if (rot.val1 < 0 && !left) {
				left = true;
				printk("    left: ok\n");
			} else if (rot.val1 > 0 && !right) {
				right = true;
				printk("    right: ok\n");
			}
		}
		k_msleep(20);
	}

	note("left %s, right %s", left ? "ok" : "NOT seen", right ? "ok" : "NOT seen");
	return (left && right) ? PASS : FAIL;
}
#endif

#if DT_NODE_EXISTS(DT_ALIAS(led_strip))
#define STRIP_NODE     DT_ALIAS(led_strip)
/* WS2812 can't report its length; bits past the last LED fall off the end */
#define STRIP_MAX_LEN  256
#define SYMBOL_BITS    DT_PROP(STRIP_NODE, bits_per_symbol)
#define SPI_HZ         DT_PROP(STRIP_NODE, spi_max_frequency)
#define PREAMBLE_BYTES DIV_ROUND_UP(DT_PROP(STRIP_NODE, reset_delay) * (SPI_HZ / 1000000), 8)
#define FRAME_BYTES    (PREAMBLE_BYTES + DIV_ROUND_UP(STRIP_MAX_LEN * 24 * SYMBOL_BITS, 8) + 1)

static uint8_t strip_frame[FRAME_BYTES];

/* Same raw-SPI encoding as the blinky sample */
static int strip_fill(const struct spi_dt_spec *spi, uint8_t r, uint8_t g, uint8_t b)
{
	const uint8_t grb[3] = { g, r, b };
	const struct spi_buf buf = { .buf = strip_frame, .len = sizeof(strip_frame) };
	const struct spi_buf_set tx = { .buffers = &buf, .count = 1 };
	size_t bit = PREAMBLE_BYTES * 8;

	memset(strip_frame, 0, sizeof(strip_frame));
	for (int i = 0; i < STRIP_MAX_LEN; i++) {
		for (int c = 0; c < 3; c++) {
			for (int k = 7; k >= 0; k--) {
				uint8_t sym = (grb[c] & BIT(k)) ? DT_PROP(STRIP_NODE, spi_one_frame)
								: DT_PROP(STRIP_NODE, spi_zero_frame);

				for (int s = SYMBOL_BITS - 1; s >= 0; s--, bit++) {
					if (sym & BIT(s)) {
						strip_frame[bit / 8] |= 0x80 >> (bit % 8);
					}
				}
			}
		}
	}

	return spi_write_dt(spi, &tx);
}

static enum result test_led_strip(void)
{
	static const struct spi_dt_spec spi = SPI_DT_SPEC_GET(
		STRIP_NODE, SPI_OP_MODE_MASTER | SPI_TRANSFER_MSB | SPI_WORD_SET(8));
	static const struct gpio_dt_spec en = GPIO_DT_SPEC_GET(USER_NODE, extled_en_gpios);
	static const struct gpio_dt_spec fault = GPIO_DT_SPEC_GET(USER_NODE, extled_fault_gpios);
	/* Dim, so a full-length strip stays within the VLED switch limit */
	static const uint8_t colors[][3] = {
		{ 16, 0, 0 }, { 0, 16, 0 }, { 0, 0, 16 }, { 10, 10, 10 }, { 0, 0, 0 },
	};
	bool faulted = false;
	int ans = -EAGAIN;

	if (!spi_is_ready_dt(&spi) || !gpio_is_ready_dt(&en) || !gpio_is_ready_dt(&fault)) {
		note("SPI/GPIO not ready");
		return FAIL;
	}

	gpio_pin_configure_dt(&fault, GPIO_INPUT);
	gpio_pin_configure_dt(&en, GPIO_OUTPUT_ACTIVE);
	k_msleep(20);

	printk("    The LED strip cycles red, green, blue, white, off.\n"
	       "    All LEDs show every color? [y/n]\n");
	key_flush();
	for (size_t i = 0; ans < 0; i = (i + 1) % ARRAY_SIZE(colors)) {
		if (strip_fill(&spi, colors[i][0], colors[i][1], colors[i][2]) < 0) {
			note("SPI write failed");
			gpio_pin_set_dt(&en, 0);
			return FAIL;
		}
		ans = yn_wait(K_MSEC(700));
		faulted |= gpio_pin_get_dt(&fault) > 0;
	}

	(void)strip_fill(&spi, 0, 0, 0);
	gpio_pin_set_dt(&en, 0);

	if (faulted) {
		note("VLED switch reported FAULT (overcurrent/short)");
		return FAIL;
	}

	note("operator: R/G/B/W on all LEDs %s, VLED no fault", ans ? "ok" : "NOT ok");
	return ans ? PASS : FAIL;
}
#endif

#if DT_NODE_EXISTS(DT_ALIAS(qwiic_i2c))
#define QWIIC_NODE DT_ALIAS(qwiic_i2c)

static enum result test_qwiic(void)
{
	const struct device *bus = DEVICE_DT_GET(QWIIC_NODE);
	const struct gpio_dt_spec scl = GPIO_DT_SPEC_GET(QWIIC_NODE, scl_gpios);
	const struct gpio_dt_spec sda = GPIO_DT_SPEC_GET(QWIIC_NODE, sda_gpios);
	char found[48] = "";
	size_t n = 0;

	if (!device_is_ready(bus)) {
		note("Qwiic I2C driver not ready");
		return FAIL;
	}

	/* On-board 10k pull-ups hold an idle bus high */
	if (gpio_pin_get_dt(&scl) != 1 || gpio_pin_get_dt(&sda) != 1) {
		note("bus not idle high: SCL %d SDA %d (pull-ups, short?)",
		     gpio_pin_get_dt(&scl), gpio_pin_get_dt(&sda));
		return FAIL;
	}

	for (uint16_t addr = 0x08; addr < 0x78; addr++) {
		uint8_t dummy;

		if (i2c_read(bus, &dummy, 1, addr) == 0) {
			size_t len = strlen(found);

			snprintf(found + len, sizeof(found) - len, " 0x%02x", addr);
			n++;
		}
	}

	if (n == 0U) {
		note("lines idle high; no device on the connector (plug one in to test)");
		return WARN;
	}

	note("lines idle high; %zu device(s):%s", n, found);
	return PASS;
}
#endif

#if DT_NODE_HAS_PROP(USER_NODE, power_off_gpios)
static enum result test_power_off(void)
{
	const struct gpio_dt_spec off = GPIO_DT_SPEC_GET(USER_NODE, power_off_gpios);

	if (hw_running_all) {
		note("skipped in 'hw run'; 'hw run power_off' turns the headset off");
		return SKIP;
	}

	printk("    Turning off in 2 s. On battery the headset must go dark;\n"
	       "    press the power button to turn it on again. (On USB only it may stay on.)\n");
	k_msleep(2000);
	gpio_pin_configure_dt(&off, GPIO_OUTPUT_ACTIVE);
	k_msleep(1000);
	gpio_pin_configure_dt(&off, GPIO_INPUT);

	note("still running 1 s after KILL: board is powered from USB, or KILL is not wired");
	return WARN;
}
#endif

const struct hw_test hw_tests[] = {
	{ "leds", "RGB status LED", test_leds },
	{ "clocks", "32 kHz and 32 MHz crystals", test_clocks },
	{ "i2c", "TAC5211 and MAX17048 respond on I2C", test_i2c },
	{ "fuel_gauge", "MAX17048 battery voltage and charge", test_fuel_gauge },
	{ "audio", "I2S + TAC5211: tone to speaker, picked up by mic", test_audio },
	{ "codec_gpio", "TAC5211 GPO1/GPI1 lines to the MCU", test_codec_gpio },
	{ "usb", "USB VBUS and enumeration by the host", test_usb },
	{ "radio", "Net core, BLE scan + advertise, nRF21540 at 20 dBm", test_radio },
#if DT_NODE_EXISTS(DT_ALIAS(led_strip))
	{ "led_strip", "WS2812 strip and VLED switch", test_led_strip },
#endif
#if DT_NODE_EXISTS(DT_ALIAS(qwiic_i2c))
	{ "qwiic", "Qwiic connector pull-ups and device scan", test_qwiic },
#endif
#if DT_NODE_EXISTS(DT_ALIAS(fuel_gauge_alert))
	{ "gauge_alert", "MAX17048 ALRT pin idle", test_gauge_alert },
#endif
	{ "buttons", "Press every button", test_buttons },
#if DT_NODE_EXISTS(DT_ALIAS(qdec0))
	{ "encoder", "Rotary encoder", test_encoder },
#endif
#if DT_NODE_HAS_PROP(USER_NODE, io_channels)
	{ "pot", "Volume potentiometer full range", test_pot },
#endif
#if DT_NODE_EXISTS(DT_ALIAS(jack_detect))
	{ "jack", "Headphone jack detect", test_jack },
#endif
#if DT_NODE_EXISTS(DT_ALIAS(charge_status))
	{ "charging", "USB -> BQ24075 -> battery, /CHG and gauge agree", test_charging },
#endif
	{ "rf_audio", "Radio noise in mic/speaker: measure, then listen", test_rf_audio },
#if DT_NODE_HAS_PROP(USER_NODE, power_off_gpios)
	{ "power_off", "LTC2950 KILL turns the headset off (by name only)", test_power_off },
#endif
};

const size_t hw_tests_count = ARRAY_SIZE(hw_tests);
```
