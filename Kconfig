## Kconfig
```kconfig
# Copyright (c) 2026 Troposound
# SPDX-License-Identifier: Apache-2.0

menu "Troposound"

rsource "drivers/Kconfig"
rsource "lib/Kconfig"

endmenu
```

## boards/troposound/h1/Kconfig.h1
```kconfig
# Copyright (c) 2026 Troposound
# SPDX-License-Identifier: Apache-2.0

config BOARD_H1
	select SOC_NRF5340_CPUAPP_QKAA if BOARD_H1_NRF5340_CPUAPP
	select SOC_NRF5340_CPUNET_QKAA if BOARD_H1_NRF5340_CPUNET
```

## boards/troposound/h1/board.yml
```yaml
# Copyright (c) 2026 Troposound
# SPDX-License-Identifier: Apache-2.0

board:
  name: h1
  full_name: H1
  vendor: troposound
  socs:
    - name: nrf5340
```

## boards/troposound/r1/Kconfig.defconfig
```kconfig
# Copyright (c) 2026 Troposound
# SPDX-License-Identifier: Apache-2.0

config HW_STACK_PROTECTION
	default ARCH_HAS_STACK_PROTECTION

if BOARD_R1_NRF5340_CPUAPP

config BT_HCI_IPC
	default y if BT_HCI

config HEAP_MEM_POOL_ADD_SIZE_BOARD
	int
	default 4096 if BT_HCI_IPC

endif # BOARD_R1_NRF5340_CPUAPP

# nRF21540 MODE is pulled down: fixed POUTA gain of 20 dB
if BOARD_R1_NRF5340_CPUNET

config MPSL_FEM_NRF21540_TX_GAIN_DB
	default MPSL_FEM_NRF21540_TX_GAIN_DB_POUTA

config BT_CTLR_TX_PWR_ANTENNA
	default 20

endif # BOARD_R1_NRF5340_CPUNET
```

## boards/troposound/r1/Kconfig.r1
```kconfig
# Copyright (c) 2026 Troposound
# SPDX-License-Identifier: Apache-2.0

config BOARD_R1
	select SOC_NRF5340_CPUAPP_QKAA if BOARD_R1_NRF5340_CPUAPP
	select SOC_NRF5340_CPUNET_QKAA if BOARD_R1_NRF5340_CPUNET
```

## boards/troposound/r1/board.yml
```yaml
# Copyright (c) 2026 Troposound
# SPDX-License-Identifier: Apache-2.0

board:
  name: r1
  full_name: R1
  vendor: troposound
  socs:
    - name: nrf5340
```

## drivers/Kconfig
```kconfig
# Copyright (c) 2026 Troposound
# SPDX-License-Identifier: Apache-2.0

rsource "audio/tac5211/Kconfig"
```

## drivers/audio/tac5211/Kconfig
```kconfig
# Copyright (c) 2026 Troposound
# SPDX-License-Identifier: Apache-2.0

config AUDIO_CODEC_TAC5211
	bool "TI TAC5211 audio codec"
	default y
	depends on DT_HAS_TI_TAC5211_ENABLED && AUDIO_CODEC
	select I2C
	select GPIO
	help
	  Enable the TAC5211 codec driver.

config TAC5211_INIT_PRIORITY
	int "TAC5211 init priority"
	default 60
	depends on AUDIO_CODEC_TAC5211
	help
	  POST_KERNEL init priority. Must be later than the I2C controller.

config TAC5211_ADC_GAIN_HALF_DB
	int "Microphone ADC digital gain (0.5 dB steps)"
	range 0 94
	default 60
	depends on AUDIO_CODEC_TAC5211
	help
	  ADC_CH1_CFG2 digital gain, 0 (0 dB) to 94 (+47 dB). Shared by both
	  mics, which are muxed onto ADC channel 1. This is the only gain stage
	  in the capture path (no analog PGA); prefer it over software mic gain,
	  which is applied after 16-bit quantisation.

config TAC5211_ADC_GAIN_EXT_EXTRA_HALF_DB
	int "Extra ADC gain while the headset mic is selected (0.5 dB steps)"
	range 0 94
	default 12
	depends on AUDIO_CODEC_TAC5211
	help
	  Added to TAC5211_ADC_GAIN_HALF_DB while the headset mic (IN2P) is the
	  capture input. The sum is clamped to the +47 dB register maximum.

module = TAC5211
module-str = tac5211
source "subsys/logging/Kconfig.template.log_config"
```

## dts/bindings/audio/ti,tac5211.yaml
```yaml
# Copyright (c) 2026 Troposound
# SPDX-License-Identifier: Apache-2.0

description: TI TAC5211 audio codec

compatible: "ti,tac5211"

include: i2c-device.yaml

properties:
  reset-gpios:
    type: phandle-array
    description: Optional GPIO used to reset the codec.
```

## lib/Kconfig
```kconfig
# Copyright (c) 2026 Troposound
# SPDX-License-Identifier: Apache-2.0

rsource "audio_i2s/Kconfig"
rsource "headset/Kconfig"
rsource "volume/Kconfig"
```

## lib/audio_i2s/Kconfig
```kconfig
# Copyright (c) 2026 Troposound
# SPDX-License-Identifier: Apache-2.0

config TROPOSOUND_AUDIO_I2S
	bool "I2S0 master for the TAC5211 (48 kHz, 16-bit stereo)"
	depends on DT_HAS_NORDIC_NRF_I2S_ENABLED
	select NRFX_I2S
	select PINCTRL
	help
	  Clocked from the 12.288 MHz audio PLL, so LRCK is exactly 48 kHz.

config TROPOSOUND_AUDIO_I2S_BLOCK_WORDS
	int "Words per DMA block (one word = one stereo 16-bit frame)"
	default 480
	depends on TROPOSOUND_AUDIO_I2S
	help
	  48 = 1 ms, 480 = 10 ms (one LC3 frame).
```

## lib/headset/Kconfig
```kconfig
# Copyright (c) 2026 Troposound
# SPDX-License-Identifier: Apache-2.0

config TROPOSOUND_HEADSET
	bool "Headset mode on the headphone jack (R1)"
	depends on AUDIO_CODEC_TAC5211
	select GPIO
	select INPUT if $(dt_alias_enabled,jack-detect)

config TROPOSOUND_HEADSET_MIC_GAIN_DB
	int "Headset mic gain on top of the codec, in dB"
	range 0 30
	default 24
	depends on TROPOSOUND_HEADSET
	help
	  Headset mics are far quieter than the built-in one. The codec adds
	  TAC5211_ADC_GAIN_EXT_EXTRA_HALF_DB, this adds the rest in software
	  through a soft clipper.
```

## lib/volume/Kconfig
```kconfig
# Copyright (c) 2026 Troposound
# SPDX-License-Identifier: Apache-2.0

DT_ZEPHYR_USER := /zephyr,user

config TROPOSOUND_VOLUME
	bool "Output volume from the volume knob (R1) or rotary encoder (H1)"
	depends on AUDIO_CODEC
	select ADC if $(dt_node_has_prop,$(DT_ZEPHYR_USER),io-channels)
	select SENSOR if $(dt_alias_enabled,qdec0)
```
